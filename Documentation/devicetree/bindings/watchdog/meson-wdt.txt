## Documentation/devicetree/bindings/watchdog/meson-wdt.txt
```
Meson SoCs Watchdog timer

Required properties:

- compatible : depending on the SoC this should be one of:
	"amlogic,meson6-wdt"
	"amlogic,meson8-wdt"
	"amlogic,meson8b-wdt"
	"amlogic,meson8m2-wdt"
- reg : Specifies base physical address and size of the registers.

Example:

wdt: watchdog@c1109900 {
	compatible = "amlogic,meson6-wdt";
	reg = <0xc1109900 0x8>;
};
```

## drivers/firmware/meson/Kconfig
```kconfig
# SPDX-License-Identifier: GPL-2.0-only

config MESON_MX_AO_ARC_FIRMWARE
	tristate "Amlogic Meson6/8/8b/8m2 AO ARC firmware support"
	depends on HAS_IOMEM
	depends on ARM
	depends on ARCH_MESON || COMPILE_TEST
	help
	  Say m or y here to enable support for the firmware using
	  the AO ARC remote processor on Amlogic Meson6/Meson8/Meson8b
	  and Meson8m2 SoCs. This enables system suspend.
	  If unusre say N.

#
# Amlogic Secure Monitor driver
#
config MESON_SM
	bool
	default ARCH_MESON
	depends on ARM64_4K_PAGES
	help
	  Say y here to enable the Amlogic secure monitor driver
```

## drivers/gpu/drm/bridge/transwitch/Kconfig
```kconfig
# SPDX-License-Identifier: GPL-2.0-or-later
config DRM_TRANSWITCH_TXC_48352
	tristate
	depends on DRM
	depends on REGMAP
	select CEC_CORE if CEC_NOTIFIER
```

## drivers/gpu/drm/meson/Kconfig
```kconfig
# SPDX-License-Identifier: GPL-2.0-only
config DRM_MESON
	tristate "DRM Support for Amlogic Meson Display Controller"
	depends on DRM && OF && (ARM || ARM64)
	depends on ARCH_MESON || COMPILE_TEST
	select DRM_KMS_HELPER
	select DRM_GEM_DMA_HELPER
	select DRM_DISPLAY_CONNECTOR
	select VIDEOMODE_HELPERS
	select REGMAP_MMIO
	select MESON_CANVAS
	select CEC_CORE if CEC_NOTIFIER
	imply PHY_MESON_CVBS_DAC

config DRM_MESON_DW_HDMI
	tristate "HDMI Synopsys Controller support for Amlogic Meson Display"
	depends on DRM_MESON
	default y if DRM_MESON
	select DRM_DW_HDMI
	imply DRM_DW_HDMI_I2S_AUDIO

config DRM_MESON_DW_MIPI_DSI
	tristate "MIPI DSI Synopsys Controller support for Amlogic Meson Display"
	depends on DRM_MESON
	default y if DRM_MESON
	select DRM_DW_MIPI_DSI
	select GENERIC_PHY_MIPI_DPHY

config DRM_MESON_TRANSWITCH_HDMI
	tristate "Amlogic Meson8/8b/8m2 TranSwitch HDMI 1.4 Controller support"
	depends on ARM || COMPILE_TEST
	depends on DRM_MESON
	default y if DRM_MESON
	select DRM_DISPLAY_HDMI_HELPER
	select DRM_DISPLAY_HELPER
	select REGMAP_MMIO
	select SND_SOC_HDMI_CODEC if SND_SOC
```

## drivers/soc/amlogic/Kconfig
```kconfig
menu "Amlogic SoC drivers"

config MESON_REGMAP_PWRC
	bool
	select REGMAP
	select PM_GENERIC_DOMAINS

config MESON_AO_PWRC
	bool "Amlogic Meson Always-On Power Domains"
	depends on ARCH_MESON || COMPILE_TEST
	depends on PM && OF
	default ARCH_MESON
	select MESON_REGMAP_PWRC
	select MFD_SYSCON
	help
	  Say yes to expose the Always-On Power Domains as Generic
	  Power Domains on Amlogic Meson SoCs.

config MESON_CANVAS
	tristate "Amlogic Meson Canvas driver"
	depends on ARCH_MESON || COMPILE_TEST
	default n
	help
	  Say yes to support the canvas IP for Amlogic SoCs.

config MESON_CLK_MEASURE
	bool "Amlogic Meson SoC Clock Measure driver"
	depends on ARCH_MESON || COMPILE_TEST
	default ARCH_MESON
	select REGMAP_MMIO
	help
	  Say yes to support of Measuring a set of internal SoC clocks
	  from the debugfs interface.

config MESON_GX_SOCINFO
	bool "Amlogic Meson GX SoC Information driver"
	depends on ARCH_MESON || COMPILE_TEST
	default ARCH_MESON
	select SOC_BUS
	help
	  Say yes to support decoding of Amlogic Meson GX SoC family
	  information about the type, package and version.

config MESON_GX_PM_DOMAINS
	bool "Amlogic Meson GX Power Domains driver"
	depends on ARCH_MESON || COMPILE_TEST
	depends on PM && OF
	default ARCH_MESON
	select PM_GENERIC_DOMAINS
	select PM_GENERIC_DOMAINS_OF
	help
	  Say yes to expose Amlogic Meson GX Power Domains as
	  Generic Power Domains.

config MESON_HHI_MEM_PWRC
	bool "Amlogic Meson HHI Memory Power Domains"
	depends on ARCH_MESON || COMPILE_TEST
	depends on PM && OF
	default ARCH_MESON
	select MESON_REGMAP_PWRC
	select MFD_SYSCON
	help
	  Say yes to expose the HHI Memory Power Domains as Generic
	  Power Domains on Amlogic Meson SoCs.

config MESON_MX_SOCINFO
	bool "Amlogic Meson MX SoC Information driver"
	depends on ARCH_MESON || COMPILE_TEST
	default ARCH_MESON
	select SOC_BUS
	help
	  Say yes to support decoding of Amlogic Meson6, Meson8,
	  Meson8b and Meson8m2 SoC family information about the type
	  and version.

endmenu
```

## drivers/soc/lantiq/Kconfig
```kconfig
config LANTIQ_FPI_BUS
	tristate "Lantiq FPI bus"
	depends on SOC_XWAY || COMPILE_TEST
	default SOC_XWAY
	help
	  Enable support for the FPI bus on Lantiq XWAY SoCs

config LANTIQ_EBU
	bool "Lantiq EBU"
	depends on LANTIQ || COMPILE_TEST
	default LANTIQ
	select IRQ_DOMAIN
	select REGMAP_MMIO
	help
	  Enable support for the External Bus Unit (EBU) on Lantiq SoCs
```
