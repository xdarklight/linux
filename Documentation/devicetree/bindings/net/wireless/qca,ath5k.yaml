## Documentation/devicetree/bindings/pci/lantiq,pcie.yaml
```yaml
# SPDX-License-Identifier: (GPL-2.0-only OR BSD-2-Clause)
%YAML 1.2
---
$id: http://devicetree.org/schemas/phy/lantiq,vrx200-pcie-phy.yaml#
$schema: http://devicetree.org/meta-schemas/core.yaml#

title: Lantiq PCIe Controller Device Tree Bindings

maintainers:
  - Martin Blumenstingl <martin.blumenstingl@googlemail.com>

properties:

  compatible:
    oneOf:
      - items:
          - enum:
              - lantiq,vrx200-pcie
              - lantiq,arx300-pcie
          - const: lantiq,dw-pcie
          - const: snps,dw-pcie

  reg:
    items:
      - description: The DesignWare PCIe controller's DBI register space
      - description: The PCI configuration space
      - description: The Lantiq PCIe Controller application register space

  reg-names:
    items:
      - const: dbi
      - const: config
      - const: app

  ranges: true

  "#address-cells":
    enum: [ 3 ]

  "#size-cells":
    enum: [ 2 ]

  device_type:
    items:
      - const: pci

  interrupts:
    items:
      - description: The PCIe Controller IR interrupt line

  interrupt-names:
    items:
      - const: ir

  "#interrupt-cells":
    description: TODO

  interrupt-map:
    description: TODO

  interrupt-map-mask:
    description: TODO

  lantiq,rcu:
    $ref: /schemas/types.yaml#/definitions/phandle
    description: phandle to the RCU syscon

  lantiq,rcu-endian-offset:
    $ref: /schemas/types.yaml#/definitions/uint32
    description: the offset of the endian registers for this PHY instance in the RCU syscon

  lantiq,rcu-inbound-big-endian-mask:
    $ref: /schemas/types.yaml#/definitions/uint32
    description: the mask to control the inbound endianness conversion

  lantiq,rcu-outbound-big-endian-mask:
    $ref: /schemas/types.yaml#/definitions/uint32
    description: the mask to control the output endianness conversion

  big-endian:
    description: Configures the PDI (PHY) registers in big-endian mode
    type: boolean

  little-endian:
    description: Configures the PDI (PHY) registers in big-endian mode
    type: boolean

  resets:
    maxItems: 1
    description: phandle to the reset line which is shared between the PCIe core and PHY

  clocks:
    items:
      - description: the PCIe controller module clock
      - description: the PCIe bus clock
      - description: the AHB clock

  clock-names:
    items:
      - const: ctrl
      - const: pcie_bus
      - const: ahb

  phys:
    $ref: /schemas/types.yaml#/definitions/phandle
    description: phandle to the PCIe PHY

  phy-names:
    items:
      - const: pcie

  num-lanes:
    $ref: /schemas/types.yaml#/definitions/uint32
    description: the number of PCIe lanes which are used by this controller

  reset-gpios:
    maxItems: 1
    description: phandle to the reset GPIO, see designware-pcie.txt


required:
  - compatible
  - reg
  - reg-names
  - ranges
  - "#address-cells"
  - "#size-cells"
  - device_type
  - interrupts
  - interrupt-names
  - "#interrupt-cells"
  - lantiq,rcu
  - lantiq,rcu-endian-offset
  - lantiq,rcu-inbound-big-endian-mask
  - lantiq,rcu-outbound-big-endian-mask
  - resets
  - clocks
  - clock-names
  - phys
  - phy-names


additionalProperties: true

examples:
  - |
    #include <dt-bindings/gpio/gpio.h>

    pcie: pcie@d900000 {
        compatible = "lantiq,xrx200-pcie", "snps,dw-pcie";

        reg = <0xd900000 0x1000>,
              <0xd000000 0x800000>,
              <0xe100900 0x200>;
        reg-names = "dbi", "config", "app";

        ranges = <0x02000000 0 0         0xc000000 0 0x1000000
                  0x01000000 0 0xd800000 0xd800000 0 0x0100000>;

        #address-cells = <3>;
        #size-cells = <2>;
        device_type = "pci";

        interrupts = <161>;
        interrupt-names = "ir";
        #interrupt-cells = <1>;
        interrupt-map-mask = <0 0 0 0x7>;
        interrupt-map = <0 0 0 1 &icu0 144>, /* int_a */
                        <0 0 0 2 &icu0 145>, /* int_b */
                        <0 0 0 3 &icu0 146>, /* int_c */
                        <0 0 0 4 &icu0 147>; /* int_d */

        lantiq,rcu = <&rcu0>;
        lantiq,rcu-endian-offset = <0x4c>;
        lantiq,rcu-inbound-big-endian-mask = <0x2>; /* bit 1 */
        lantiq,rcu-outbound-big-endian-mask = <0x14>; /* bit 4 */
        big-endian;

        resets = <&reset0 22 22>;

        clocks = <&pmu 33>, <&pmu 31>, <&pmu 13>;
        clock-names = "ctrl", "pcie_bus", "ahb";

        phys = <&pcie_phy>;
        phy-names = "pcie";

        num-lanes = <1>;

        reset-gpios = <&gpio 38 GPIO_ACTIVE_LOW>;
    };
```

## Documentation/devicetree/bindings/pci/lantiq,xway-pci.yaml
```yaml
# SPDX-License-Identifier: (GPL-2.0-only OR BSD-2-Clause)
%YAML 1.2
---
$id: http://devicetree.org/schemas/pci/lantiq,xway-pci.yaml#
$schema: http://devicetree.org/meta-schemas/core.yaml#

title: Lantiq XWAY PCI Controller Device Tree Bindings

maintainers:
  - Martin Blumenstingl <martin.blumenstingl@googlemail.com>

properties:

  compatible:
    items:
      - enum:
          - lantiq,danube-pci
          - lantiq,xrx100-pci
          - lantiq,xrx200-pci
      - const: lantiq,xway-pci

  reg:
    minItems: 2
    items:
      - description: The PCI controller register space
      - description: The PCI configuration space

  reg-names:
    items:
      - const: ctrl
      - const: config

  interrupts:
    minItems: 2
    items:
      - description: The PCI Controller IR interrupt line
      - description: The PCI wake interrupt line

  interrupt-names:
    items:
      - const: ir
      - const: wake

  big-endian:
    description: Indicates that the registers are in big-endian mode
    type: boolean

  little-endian:
    description: Indicates that the registers are in little-endian mode
    type: boolean

  resets:
    maxItems: 1
    description: phandle to the PCI controller's reset line

  clocks:
    minItems: 2
    items:
      - description: the PCI module clock
      - description: the PCI bus clock

  clock-names:
    items:
      - const: ctl
      - const: bus

  reset-gpios:
    maxItems: 1
    description: phandle to the PCI bus reset GPIO

  lantiq,bus-clock:
    description: The rate (in Hz) of the bus clock.
    $ref: /schemas/types.yaml#/definitions/uint32
    deprecated: true

required:
  - compatible
  - reg
  - reg-names
  - interrupts
  - interrupt-names
  - resets
  - clocks

allOf:
  - $ref: /schemas/pci/pci-bus.yaml#

unevaluatedProperties: false

examples:
  - |
    #include <dt-bindings/gpio/gpio.h>
    #include <dt-bindings/interrupt-controller/irq.h>

    pci@e105400 {
      compatible = "lantiq,xrx200-pci", "lantiq,xway-pci";

      reg = <0xe105400 0x400>, <0x7000000 0x8000>;
      reg-names = "ctrl", "config";

      resets = <&reset0 13 13>;
      clocks = <&pmu 4>, <&cgu 0>;
      clock-names = "ctl", "bus";

      interrupts = <57>, <58>;
      interrupt-names = "ir", "wake";

      bus-range = <0x0 0xf>;
      ranges = <0x02000000 0 0x18000000 0x8000000 0 0x2000000   /* MEM */
                0x01000000 0 0x00000000 0xae00000 0 0x0200000>; /* I/O */

      lantiq,bus-clock = <33333333>;
      req-mask = <0x1>; /* GNT1 */

      device_type = "pci";

      reset-gpios = <&gpio 21 GPIO_ACTIVE_LOW>;

      #interrupt-cells = <1>;
      interrupt-map-mask = <0xf800 0x0 0x0 0x7>;
      interrupt-map = <0x7000 0 0 1 &ebu0 0 IRQ_TYPE_LEVEL_LOW>; /* slot 14 */

      #address-cells = <3>;
      #size-cells = <2>;
    };
```

## Documentation/devicetree/bindings/pci/lantiq-pcie.txt
```
* Lantiq PCI express root complex


Required properties:
- compatible:	must be "lantiq,<soc-model>-pcie", "snps,dw-pcie"
		where soc-model is xrx200
- reg:	the DesignWare PCIe controller's dbi registers, the PCI config space
	and the PCIe controller application registers, see designware-pcie.txt
- reg-names:	must contain "dbi", "config" and "app", see designware-pcie.txt
- ranges:	ranges for the PCI memory and I/O regions
		see designware-pcie.txt
- interrupts:	the PCIe application and MSI interrupt lines
- interrupt-names:	must contain "app" and "msi"
- lantiq,rcu:	a phandle to the RCU syscon
- resets:	must contain a phandle to the PCIe reset line which is shared
		between the PCIe core and the PCIe PHY
- clocks:	must contain a phandle to the PCIe core and bus clocks
- clock-names:	must contain "pcie", "pcie_bus" and "ahb"
		see designware-pcie.txt
- phys:		must contain a phandle to the PCIe PHY
- phy-names:	must be "pcie"
- #address-cells:	set to <3>, see designware-pcie.txt
- #size-cells:	set to <2>, see designware-pcie.txt
- device_type:	set to "pci", see designware-pcie.txt
- #interrupt-cells:	set to <1>, see designware-pcie.txt
- interrupt-map-mask and interrupt-map:	see designware-pcie.txt

Optional properties:
- num-lanes:	number of lanes to use, see designware-pcie.txt
- reset-gpios:	phandle to the reset GPIO, see designware-pcie.txt
- big-endian:		configure the PCIe AHB slave as big-endian
- little-endian:	configure the PCIe AHB slave as little-endian


Example:
	pcie: pcie@d900000 {
		compatible = "lantiq,xrx200-pcie", "snps,dw-pcie";

		reg = <0xd900000 0x1000>,
		      <0xd000000 0x800000>,
		      <0xe100900 0x200>;
		reg-names = "dbi", "config", "app";
		ranges = <0x02000000 0 0         0xc000000 0 0x1000000
			  0x01000000 0 0xd800000 0xd800000 0 0x0100000>;

		interrupts = <161>, <144>;
		interrupt-names = "app", "msi";
		#interrupt-cells = <1>;

		lantiq,rcu = <&rcu0>;
		big-endian;

		clocks = <&pmu PCIE_CTL>, <&pmu PCIE_BUS>, <&pmu AHB>;
		clock-namems = "pcie", "pcie_bus", "ahb";
		resets = <&reset0 22 22>;
		phys = <&pcie_phy LANTIQ_PCIE_PHY_MODE_36MHZ>;
		phy-names = "pcie";

		num-lanes = <1>;
		reset-gpios = <&gpio 38 GPIO_ACTIVE_LOW>;

		#address-cells = <3>;
		#size-cells = <2>;
		device_type = "pci";
	};
```

## Documentation/devicetree/bindings/phy/amlogic,meson-cvbs-dac-phy.yaml
```yaml
# SPDX-License-Identifier: (GPL-2.0 OR BSD-2-Clause)
%YAML 1.2
---
$id: "http://devicetree.org/schemas/phy/amlogic,meson-cvbs-dac-phy.yaml#"
$schema: "http://devicetree.org/meta-schemas/core.yaml#"

title: Amlogic Meson Composite Video Baseband Signal DAC

maintainers:
  - Martin Blumenstingl <martin.blumenstingl@googlemail.com>

description: |+
  The CVBS DAC node should be the child of a syscon node with the
  required property:

  compatible = "amlogic,meson-hhi-sysctrl", "simple-mfd", "syscon"

  Refer to the bindings described in
  Documentation/devicetree/bindings/mfd/syscon.yaml

properties:
  $nodename:
    pattern: "^video-dac@[0-9a-f]+$"

  compatible:
    oneOf:
      - items:
          - enum:
              - amlogic,meson8-cvbs-dac
              - amlogic,meson-gxbb-cvbs-dac
              - amlogic,meson-gxl-cvbs-dac
              - amlogic,meson-g12a-cvbs-dac
          - const: amlogic,meson-cvbs-dac
      - const: amlogic,meson-cvbs-dac

  reg:
    maxItems: 1

  clocks:
    minItems: 1

  nvmem-cells:
    minItems: 1

  nvmem-cell-names:
    items:
      - const: cvbs_trimming

  "#phy-cells":
    const: 0

required:
  - compatible
  - reg
  - clocks
  - "#phy-cells"

additionalProperties: false

examples:
  - |
    video-dac@2f4 {
      compatible = "amlogic,meson8-cvbs-dac", "amlogic,meson-cvbs-dac";
      reg = <0x2f4 0x8>;

      #phy-cells = <0>;

      clocks = <&vdac_clock>;

      nvmem-cells = <&cvbs_trimming>;
      nvmem-cell-names = "cvbs_trimming";
    };
  - |
    video-dac@2ec {
      compatible = "amlogic,meson-g12a-cvbs-dac", "amlogic,meson-cvbs-dac";
      reg = <0x2ec 0x8>;

      #phy-cells = <0>;

      clocks = <&vdac_clock>;
    };
```

## Documentation/devicetree/bindings/phy/amlogic,meson8-hdmi-tx-phy.yaml
```yaml
# SPDX-License-Identifier: (GPL-2.0 OR BSD-2-Clause)
%YAML 1.2
---
$id: "http://devicetree.org/schemas/phy/amlogic,meson8-hdmi-tx-phy.yaml#"
$schema: "http://devicetree.org/meta-schemas/core.yaml#"

title: Amlogic Meson8, Meson8b and Meson8m2 HDMI TX PHY

maintainers:
  - Martin Blumenstingl <martin.blumenstingl@googlemail.com>

description: |+
  The HDMI TX PHY node should be the child of a syscon node with the
  required property:

  compatible = "amlogic,meson-hhi-sysctrl", "simple-mfd", "syscon"

  Refer to the the bindings described in
  Documentation/devicetree/bindings/mfd/syscon.yaml

properties:
  compatible:
    enum:
      - amlogic,meson8-hdmi-tx-phy
      - amlogic,meson8b-hdmi-tx-phy
      - amlogic,meson8m2-hdmi-tx-phy

  clocks:
    minItems: 1
    description:
      HDMI TMDS clock

  "#phy-cells":
    const: 0

required:
  - compatible
  - "#phy-cells"

examples:
  - |
    hdmi_tx_phy: phy {
      compatible = "amlogic,meson8-hdmi-tx-phy";
      clocks = <&tmds_clock>;
      #phy-cells = <0>;
    };
```

## Documentation/devicetree/bindings/phy/lantiq,xway-rcu-usb2-phy.yaml
```yaml
# SPDX-License-Identifier: (GPL-2.0-only OR BSD-2-Clause)
%YAML 1.2
---
$id: http://devicetree.org/schemas/phy/lantiq,xway-rcu-usb2-phy.yaml#
$schema: http://devicetree.org/meta-schemas/core.yaml#

title: Lantiq XWAY SoC RCU USB 1.1/2.0 PHY binding

maintainers:
  - Martin Blumenstingl <martin.blumenstingl@googlemail.com>

properties:
  "#phy-cells":
    const: 0

  compatible:
    enum:
      - lantiq,ase-usb2-phy
      - lantiq,danube-usb2-phy
      - lantiq,xrx100-usb2-phy
      - lantiq,xrx200-usb2-phy
      - lantiq,xrx300-usb2-phy

  reg:
    minItems: 2

  clocks:
    minItems: 1

  clock-names:
    items:
      - const: phy

  resets:
    minItems: 1
    maxItems: 2

  reset-names:
    items:
      - const: phy
      - const: ctrl

required:
  - "#phy-cells"
  - compatible
  - reg
  - clocks
  - clock-names
  - resets
  - reset-names

additionalProperties: false

examples:
  - |
    usb_phy0: usb2-phy@18 {
        compatible = "lantiq,xrx200-usb2-phy";
        reg = <0x18 4>, <0x38 4>;

        clocks = <&pmu_USB0_PHY>;
        clock-names = "phy";

        resets = <&reset1 4 4>, <&reset0 4 4>;
        reset-names = "phy", "ctrl";

        #phy-cells = <0>;
    };
...
```

## Documentation/devicetree/bindings/phy/meson-gxl-usb2-phy.txt
```
* Amlogic Meson GXL and GXM USB2 PHY binding

Required properties:
- compatible:	Should be "amlogic,meson-gxl-usb2-phy"
- reg:		The base address and length of the registers
- #phys-cells:	must be 0 (see phy-bindings.txt in this directory)

Optional properties:
- clocks:	phandle and clock identifier for the phy clocks
- clock-names:	"usb" and "usb_ddr"
- resets:	reference to the reset controller
- phy-supply:	see phy-bindings.txt in this directory


Example:
	usb2_phy0: phy@78000 {
		compatible = "amlogic,meson-gxl-usb2-phy";
		#phy-cells = <0>;
		reg = <0x0 0x78000 0x0 0x20>;
		clocks = <&clkc CLKID_USB1>, <&clkc CLKID_USB1_DDR_BRIDGE>;
		clock-names = "usb", "usb_ddr";
	};
```

## Documentation/devicetree/bindings/phy/meson-gxl-usb3-phy.txt
```
* Amlogic Meson GXL and GXM USB3 PHY and OTG detection binding

Required properties:
- compatible:	Should be "amlogic,meson-gxl-usb3-phy"
- reg:		The base address and length of the registers
- #phys-cells:	must be 0 (see phy-bindings.txt in this directory)

Optional properties:
- interrupts:	the interrupt specifier for the OTG detection
- phy-supply:	see phy-bindings.txt in this directory


Example:
	usb3_phy0: phy@78080 {
		compatible = "amlogic,meson-gxl-usb3-phy";
		#phy-cells = <0>;
		reg = <0x0 0x78080 0x0 0x20>;
		interrupts = <GIC_SPI 16 IRQ_TYPE_LEVEL_HIGH>;
	};
```
