## Documentation/devicetree/bindings/net/wireless/qca,ath5k.yaml
```yaml
# SPDX-License-Identifier: (GPL-2.0-only OR BSD-2-Clause)
%YAML 1.2
---
$id: http://devicetree.org/schemas/net/wireless/qca,ath5k.yaml#
$schema: http://devicetree.org/meta-schemas/core.yaml#

title: Qualcomm Atheros ath5k wireless devices Generic Binding

maintainers:
  - Martin Blumenstingl <martin.blumenstingl@googlemail.com>

description: |
  These are dt entries for Qualcomm Technologies, Inc. IEEE 802.11abg
  devices connected through either a PCI or AHB bus.

properties:
  $nodename:
    pattern: '^wifi@.*'

  compatible:
    enum:
      - pci168c,0007 # 5210
      - pci168c,0011 # 5311 - this is on AHB bus !
      - pci168c,0012 # 5211
      - pci168c,0013 # 5212
      - pci168c,0014 # 5212 compatible
      - pci168c,0015 # 5212 compatible
      - pci168c,0016 # 5212 compatible
      - pci168c,0017 # 5212 compatible
      - pci168c,0018 # 5212 compatible
      - pci168c,0019 # 5212 compatible
      - pci168c,001a # 2413 Griffin-lite
      - pci168c,001b # 5413 Eagle
      - pci168c,001c # PCI-E cards
      - pci168c,001d # 2417 Nala
      - pci168c,0207 # 5210 early
      - pci168c,0207 # 5210 early
      - pci168c,1014 # IBM minipci 5212
      - pci168c,ff1b # AR5BXB63

  reg:
    maxItems: 1

  qca,no-eeprom:
    type: boolean
    description: |
      Indicates that there is no physical EEPROM connected to the
      wireless chip. In this case the calibration / EEPROM data has to
      be loaded from an nvmem-cell

  nvmem-cells:
    minItems: 1
    maxItems: 2

  nvmem-cell-names:
    minItems: 1
    maxItems: 2
    items:
      - const: eeprom
      - const: mac-address

required:
  - compatible
  - reg

additionalProperties: false

examples:
  - |
    pci0 {
      #address-cells = <3>;
      #size-cells = <2>;

      wifi@e,0,0 {
        compatible = "pci168c,001d";
        reg = <0x7000 0 0 0 0>;
        qca,no-eeprom;
        nvmem-cells = <&ath5k_eeprom>, <&ath5k_mac_address>;
        nvmem-cell-names = "eeprom", "mac-address";
      };
    };
```

## Documentation/devicetree/bindings/net/wireless/qca,ath9k.txt
```
* Qualcomm Atheros ath9k wireless devices

This node provides properties for configuring the ath9k wireless device. The
node is expected to be specified as a child node of the PCI controller to
which the wireless chip is connected.

Required properties:
- compatible: For PCI and PCIe devices this should be an identifier following
		the format as defined in "PCI Bus Binding to Open Firmware"
		Revision 2.1. One of the possible formats is "pciVVVV,DDDD"
		where VVVV is the PCI vendor ID and DDDD is PCI device ID.
- reg: Address and length of the register set for the device.

Optional properties:
- qca,no-eeprom: Indicates that there is no physical EEPROM connected to the
			ath9k wireless chip (in this case the calibration /
			EEPROM data will be loaded from userspace using the
			kernel firmware loader).
- qca,check-eeprom-endianness: When enabled, the driver checks if the
				endianness of the EEPROM (using two checks,
				one is based on the two magic bytes at the
				start of the EEPROM and a second one which
				relies on a flag within the EEPROM data)
				matches the host system's native endianness.
				The data will be swapped accordingly if there
				is a mismatch.
				Leaving this disabled means that the EEPROM
				data will always be interpreted in the
				system's native endianness.
				Enable this option only when the EEPROMs
				endianness identifiers are known to be
				correct, because otherwise the EEPROM data
				may be swapped and thus interpreted
				incorrectly.
- mac-address: See ethernet.txt in the parent directory
- local-mac-address: See ethernet.txt in the parent directory
- disable-ieee80211-2ghz: See ieee80211.txt in the current directory
- disable-ieee80211-5ghz: See ieee80211.txt in the current directory


In this example, the node is defined as child node of the PCI controller:
&pci0 {
	ath9k@168c,002d {
		compatible = "pci168c,002d";
		reg = <0x7000 0 0 0 0x1000>;
		qca,no-eeprom;
	};
};
```

## Documentation/devicetree/bindings/pci/intel-gw-pcie.yaml
```yaml
# SPDX-License-Identifier: (GPL-2.0 OR BSD-2-Clause)
%YAML 1.2
---
$id: http://devicetree.org/schemas/pci/intel-gw-pcie.yaml#
$schema: http://devicetree.org/meta-schemas/core.yaml#

title: PCIe RC controller on Intel Gateway SoCs

maintainers:
  - Rahul Tanwar <rtanwar@maxlinear.com>

select:
  properties:
    compatible:
      contains:
        enum:
          - intel,lgm-pcie
          - lantiq,xrx200-pcie
          - lantiq,xrx300-pcie
  required:
    - compatible

allOf:
  - $ref: /schemas/pci/snps,dw-pcie.yaml#

properties:
  compatible:
    items:
      - enum:
          - intel,lgm-pcie
          - lantiq,xrx200-pcie
          - lantiq,xrx300-pcie
      - const: snps,dw-pcie

  reg:
    items:
      - description: Controller control and status registers.
      - description: PCIe configuration registers.
      - description: Controller application registers.

  reg-names:
    items:
      - const: dbi
      - const: config
      - const: app

  ranges:
    maxItems: 1

  resets:
    maxItems: 1

  clocks:
    minItems: 1
    maxItems: 3

  clock-names:
    items:
      - const: pcie
      - const: pcie_bus
      - const: ahb

  interrupts:
    minItems: 3

  interrupt-names:
    items:
      - const: ir
      - const: wake
      - const: l3

  phys:
    maxItems: 1

  phy-names:
    const: pcie

  reset-gpios:
    maxItems: 1

  num-lanes:
    maximum: 2

  max-link-speed:
    enum: [1, 2, 3, 4]
    default: 1

  reset-assert-ms:
    description: |
      Delay after asserting reset to the PCIe device.
    maximum: 500
    default: 100

  big-endian:
    $ref: /schemas/types.yaml#/definitions/flag
    description: |
      Registers need to be accessed in big endian mode.

allOf:
  - if:
      properties:
        compatible:
          contains:
            enum:
              - lantiq,xrx200-pcie
              - lantiq,xrx300-pcie
    then:
      properties:
        big-endian: true
    else:
      properties:
        big-endian: false

  - if:
      properties:
        compatible:
          contains:
            enum:
              - lantiq,xrx200-pcie
    then:
      properties:
        clocks:
          minItems: 3
    else:
      properties:
        clocks:
          maxItems: 1

required:
  - compatible
  - reg
  - reg-names
  - ranges
  - resets
  - clocks
  - phys
  - phy-names
  - reset-gpios
  - '#interrupt-cells'
  - interrupt-map
  - interrupt-map-mask

unevaluatedProperties: false

examples:
  - |
    #include <dt-bindings/gpio/gpio.h>
    pcie10: pcie@d0e00000 {
      compatible = "intel,lgm-pcie", "snps,dw-pcie";
      device_type = "pci";
      #address-cells = <3>;
      #size-cells = <2>;
      reg = <0xd0e00000 0x1000>,
            <0xd2000000 0x800000>,
            <0xd0a41000 0x1000>;
      reg-names = "dbi", "config", "app";
      linux,pci-domain = <0>;
      max-link-speed = <4>;
      bus-range = <0x00 0x08>;
      #interrupt-cells = <1>;
      interrupt-map-mask = <0 0 0 0x7>;
      interrupt-map = <0 0 0 1 &ioapic1 27 1>,
                      <0 0 0 2 &ioapic1 28 1>,
                      <0 0 0 3 &ioapic1 29 1>,
                      <0 0 0 4 &ioapic1 30 1>;
      ranges = <0x02000000 0 0xd4000000 0xd4000000 0 0x04000000>;
      resets = <&rcu0 0x50 0>;
      clocks = <&cgu0 120>;
      phys = <&cb0phy0>;
      phy-names = "pcie";
      reset-assert-ms = <500>;
      reset-gpios = <&gpio0 3 GPIO_ACTIVE_LOW>;
      num-lanes = <2>;
    };
  - |
    #include <dt-bindings/gpio/gpio.h>
    pcie@d900000 {
      compatible = "lantiq,xrx200-pcie", "snps,dw-pcie";

      #size-cells = <2>;
      #address-cells = <3>;

      reg = <0xd900000 0x1000>,
            <0xd000000 0x800000>,
            <0xe100900 0x100>;
      reg-names = "dbi", "config", "app";

      big-endian;

      ranges = <0x2000000 0 0x1c000000 0xc000000 0 0x1000000>;

      interrupts = <161>, <162>, <120>;
      interrupt-names = "ir", "wake", "l3";

      #interrupt-cells = <1>;
      interrupt-map-mask = <0 0 0 0x7>;
      interrupt-map = <0 0 0 1 &icu0 144>,
                      <0 0 0 2 &icu0 145>,
                      <0 0 0 3 &icu0 146>,
                      <0 0 0 4 &icu0 147>;

      phys = <&pcie0_phy>;
      phy-names = "pcie";

      clocks = <&clk_pcie>, <&clk_pcie_bus>, <&clk_ahb>;
      clock-names = "pcie", "pcie_bus", "ahb";

      resets = <&reset0 22 22>;

      reset-gpios = <&gpio 38 GPIO_ACTIVE_LOW>;
      num-lanes = <1>;

      device_type = "pci";
      bus-range = <0x00 0x08>;
    };
```

## Documentation/devicetree/bindings/pci/lantiq,dw-pcie.yaml
```yaml
# SPDX-License-Identifier: (GPL-2.0-only OR BSD-2-Clause)
%YAML 1.2
---
$id: http://devicetree.org/schemas/pci/lantiq,dw-pcie.yaml#
$schema: http://devicetree.org/meta-schemas/core.yaml#

title: Lantiq PCIe Controller Device Tree Bindings

maintainers:
  - Martin Blumenstingl <martin.blumenstingl@googlemail.com>

properties:

  compatible:
    items:
      - enum:
          - lantiq,arx300-pcie
          - lantiq,vrx200-pcie
      - const: lantiq,dw-pcie
      - const: snps,dw-pcie

  reg:
    items:
      - description: The DesignWare PCIe controller's DBI register space
      - description: The PCI configuration space
      - description: The Lantiq PCIe Controller application register space

  reg-names:
    items:
      - const: dbi
      - const: config
      - const: app

  ranges: true

  "#address-cells":
    enum: [ 3 ]

  "#size-cells":
    enum: [ 2 ]

  device_type:
    items:
      - const: pci

  interrupts:
    items:
      - description: The PCIe Controller IR interrupt line

  interrupt-names:
    items:
      - const: ir

  lantiq,rcu:
    $ref: /schemas/types.yaml#/definitions/phandle
    description: phandle to the RCU syscon

  lantiq,rcu-endian-offset:
    $ref: /schemas/types.yaml#/definitions/uint32
    description: the offset of the endian registers for this PHY instance in the RCU syscon

  lantiq,rcu-inbound-big-endian-mask:
    $ref: /schemas/types.yaml#/definitions/uint32
    description: the mask to control the inbound endianness conversion

  lantiq,rcu-outbound-big-endian-mask:
    $ref: /schemas/types.yaml#/definitions/uint32
    description: the mask to control the output endianness conversion

  big-endian:
    description: TODO registers in big-endian mode
    type: boolean

  little-endian:
    description: TODO registers in little-endian mode
    type: boolean

  resets:
    maxItems: 1
    description: phandle to the reset line which is shared between the PCIe core and PHY

  clocks:
    items:
      - description: the PCIe controller module clock
      - description: the PCIe bus clock
      - description: the AHB clock

  clock-names:
    items:
      - const: ctl
      - const: pcie_bus
      - const: ahb

  phys:
    $ref: /schemas/types.yaml#/definitions/phandle
    description: phandle to the PCIe PHY

  phy-names:
    items:
      - const: pcie

  num-lanes:
    $ref: /schemas/types.yaml#/definitions/uint32
    description: the number of PCIe lanes which are used by this controller

  reset-gpios:
    maxItems: 1
    description: phandle to the reset GPIO, see designware-pcie.txt

patternProperties:

  ^interrupt-controller$:
    description: The nested PCI interrupt controller for the legacy INTX and WAKE interrupts
    type: object
    properties:

      interrupts:
        items:
          - description: Legacy PCI INT_A
          - description: Legacy PCI INT_B
          - description: Legacy PCI INT_C
          - description: Legacy PCI INT_D
          - description: PCI WAKE interrupt

      interrupt-names:
        items:
          - const: int_a
          - const: int_b
          - const: int_c
          - const: int_d
          - const: wake

      interrupt-controller:
        type: boolean

      "#address-cells":
        enum: [ 0 ]

      "#interrupt-cells":
        enum: [ 1 ]

required:
  - compatible
  - reg
  - reg-names
  - ranges
  - "#address-cells"
  - "#size-cells"
  - device_type
  - interrupts
  - interrupt-names
  - "#interrupt-cells"
  - lantiq,rcu
  - lantiq,rcu-endian-offset
  - lantiq,rcu-inbound-big-endian-mask
  - lantiq,rcu-outbound-big-endian-mask
  - resets
  - clocks
  - clock-names
  - phys
  - phy-names
  - interrupt-controller

additionalProperties: true

examples:
  - |
    #include <dt-bindings/gpio/gpio.h>

    pcie: pcie@d900000 {
        compatible = "lantiq,vrx200-pcie", "lantiq,dw-pcie", "snps,dw-pcie";

        reg = <0xd900000 0x1000>,
              <0xd000000 0x800000>,
              <0xe100900 0x200>;
        reg-names = "dbi", "config", "app";

        ranges = <0x02000000 0 0         0xc000000 0 0x1000000
                  0x01000000 0 0xd800000 0xd800000 0 0x0100000>;

        #address-cells = <3>;
        #size-cells = <2>;
        device_type = "pci";

        interrupts = <161>;
        interrupt-names = "ir";
        #interrupt-cells = <1>;
        interrupt-map-mask = <0 0 0 0x7>;
        interrupt-map = <0 0 0 1 &pcie_intc 0>, /* int_a */
                        <0 0 0 2 &pcie_intc 1>, /* int_b */
                        <0 0 0 3 &pcie_intc 2>, /* int_c */
                        <0 0 0 4 &pcie_intc 3>; /* int_d */

        lantiq,rcu = <&rcu0>;
        lantiq,rcu-endian-offset = <0x4c>;
        lantiq,rcu-inbound-big-endian-mask = <0x2>; /* bit 1 */
        lantiq,rcu-outbound-big-endian-mask = <0x14>; /* bit 4 */
        big-endian;

        resets = <&reset0 22 22>;

        clocks = <&pmu 33>, <&pmu 31>, <&pmu 13>;
        clock-names = "ctl", "pcie_bus", "ahb";

        phys = <&pcie_phy>;
        phy-names = "pcie";

        num-lanes = <1>;

        reset-gpios = <&gpio 38 GPIO_ACTIVE_LOW>;

        pcie_intc: interrupt-controller {
            interrupt-parent = <&icu0>;
            interrupts = <144>, <145>, <146>, <147>, <148>;
            interrupt-names = "int_a", "int_b", "int_c", "int_d", "wake";
            interrupt-controller;
            #address-cells = <0>;
            #interrupt-cells = <1>;
        };
    };
```
