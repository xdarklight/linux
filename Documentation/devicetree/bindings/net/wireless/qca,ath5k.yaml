## Documentation/devicetree/bindings/rtc/rtc-amlogic.txt
```
* AMlogic Meson RTC

Required properties:
- compatible: should be one of the following describing the hardware:
	* "amlogic,meson6-rtc"
	* "amlogic,meson8-rtc"
	* "amlogic,meson8b-rtc"

- reg: physical register space for the controller's memory mapped registers.

Optional properties:
- resets: reset controller reference to allow reset of the controller
- interrupts: single interrupt reference if interrupt support needed

Example:

	rtc: rtc@c8100740 {
		compatible = "amlogic,meson6-rtc";
		reg = <0xc8100740 0x14>;
		status = "disabled";
	};
```

## Documentation/devicetree/bindings/sound/cirrus,cs4334.yaml
```yaml
# SPDX-License-Identifier: (GPL-2.0-only OR BSD-2-Clause)
%YAML 1.2
---
$id: http://devicetree.org/schemas/sound/cirrus,cs4334.yaml#
$schema: http://devicetree.org/meta-schemas/core.yaml#


title: Cirrus CS4334 - or functionally compatible - I2S Stereo DACs

maintainers:
  - Martin Blumenstingl <martin.blumenstingl@googlemail.com>

description: |
  Cirrus CS4334 16-24 bit stereo DAC with I2S input.
  https://statics.cirrus.com/pubs/proDatasheet/CS4334-5-8-9_F7.pdf
  http://www.mxtronics.com/n107/n124/n181/n184/c697/attr/2625.pdf

properties:
  compatible:
    enum:
      - cirrus,cs4334
      - mxtronics,mxt8234

  "#sound-dai-cells":
    const: 0

  VDD-supply:
    description:
      Regulator for the codec voltage supply

required:
  - compatible
  - "#sound-dai-cells"
  - VDD-supply

examples:
  - |
     audio-codec {
         compatible = "mxtronics,mxt8234";
         #sound-dai-cells = <0>;
         VDD-supply = <&codec_vdd>;
     };
```

## Documentation/devicetree/bindings/usb/etron,ej1x8.yaml
```yaml
# SPDX-License-Identifier: (GPL-2.0 OR BSD-2-Clause)
%YAML 1.2
---
$id: http://devicetree.org/schemas/usb/etron,ej1x8.yaml#
$schema: http://devicetree.org/meta-schemas/core.yaml#

title: EJ168/EJ188/EJ198 xHCI controllers with four GPIO lines

maintainers:
  - Martin Blumenstingl <martin.blumenstingl@googlemail.com>

allOf:
  - $ref: "usb-hcd.yaml#"

properties:
  compatible:
    enum:
      - pci1b6f,7023
      - pci1b6f,7052

  reg:
    maxItems: 1

  "#gpio-cells":
    const: 2

  gpio-controller: true

required:
  - compatible
  - reg

additionalProperties: false

examples:
  - |
      pcie {
        #address-cells = <3>;
        #size-cells = <2>;

        usb@0,0,0 {
          compatible = "pci1b6f,7023";
          reg = <0x0 0x0 0x0 0x0 0x1000>;
          gpio-controller;
          #gpio-cells = <2>;
        };
      };

...
```

## Documentation/devicetree/bindings/usb/usb-roothub.txt
```
Generic USB root-hub Properties

similar to the USB device bindings (documented in usb-device.txt from the
current directory) this provides support for configuring the root-hub.

Required properties:
- compatible: should be at least one of "usb1d6b,3", "usb1d6b,2"
- reg: must be 0.
- address-cells: must be 1
- size-cells: must be 0

Required sub-nodes:
a sub-node per actual USB port is required. each sub-node supports the
following properties:
  Required properties:
    - reg: the port number on the root-hub (mandatory)
  Optional properties:
    - phys: optional, from the *Generic PHY* bindings (mandatory needed
      when phy-names is given)
    - phy-names: optional, from the *Generic PHY* bindings; supported names
      are "usb2-phy" or "usb3-phy"

Example:
	&usb1 {
		#address-cells = <1>;
		#size-cells = <0>;

		roothub@0 {
			compatible = "usb1d6b,3", "usb1d6b,2";
			#address-cells = <1>;
			#size-cells = <0>;
			reg = <0>;

			port@1 {
				reg = <1>;
				phys = <&usb2_phy1>, <&usb3_phy1>;
				phy-names = "usb2-phy", "usb3-phy";
			};

			port@2 {
				reg = <2>;
				phys = <&usb2_phy2>, <&usb3_phy2>;
				phy-names = "usb2-phy", "usb3-phy";
			};
		};
	}
```
