## Documentation/devicetree/bindings/phy/phy-lantiq-rcu-usb2.txt
```
Lantiq XWAY SoC RCU USB 1.1/2.0 PHY binding
===========================================

This binding describes the USB PHY hardware provided by the RCU module on the
Lantiq XWAY SoCs.


-------------------------------------------------------------------------------
Required properties (controller (parent) node):
- compatible		: Should be one of
				"lantiq,ase-rcu-usb2-phy"
				"lantiq,danube-rcu-usb2-phy"
				"lantiq,xrx100-rcu-usb2-phy"
				"lantiq,xrx200-rcu-usb2-phy"
				"lantiq,xrx300-rcu-usb2-phy"
- lantiq,rcu-syscon	: A phandle to the RCU module and the offsets to the
			  USB PHY configuration and USB MAC registers.
- address-cells		: should be 1
- size-cells		: should be 0
- phy-cells		: from the generic PHY bindings, must be 1

Optional properties (controller (parent) node):
- vbus-gpio		: References a GPIO which enables VBUS all given USB
			  ports.

Required nodes		:  A sub-node is required for each USB PHY port.


-------------------------------------------------------------------------------
Required properties (port (child) node):
- reg        	: The ID of the USB port, usually 0 or 1.
- clocks	: References to the (PMU) "ctrl" and "phy" clk gates.
- clock-names	: Must be one of the following:
			"ctrl"
			"phy"
- resets	: References to the RCU USB configuration reset bits.
- reset-names	: Must be one of the following:
			"analog-config" (optional)
			"statemachine-soft" (optional)

Optional properties (port (child) node):
- vbus-gpio	: References a GPIO which enables VBUS for the USB port.


-------------------------------------------------------------------------------
Example for the USB PHYs on an xRX200 SoC:
	usb_phys: rcu-usb2-phy {
		compatible      = "lantiq,xrx200-rcu-usb2-phy";
		#address-cells	= <1>;
		#size-cells	= <0>;
		#phy-cells	= <1>;

		vbus-gpios = <&gpio 31 GPIO_ACTIVE_HIGH>;

		usb0_phy: usb-phy@0 {
			reg = <0>;

			lantiq,rcu-syscon = <&rcu0 0x18 0x10>;
			clocks = <&pmu PMU_GATE_USB0_CTRL>,
				 <&pmu PMU_GATE_USB0_PHY>;
			clock-names = "ctrl", "phy";
			vbus-gpios = <&gpio 32 GPIO_ACTIVE_HIGH>;
			resets = <&rcu 0x38 0>, <&rcu 0x48 4>;
			reset-names = "analog-config", "statemachine-soft";
		};

		usb1_phy: usb-phy {
			reg = <1>;

			lantiq,rcu-syscon = <&rcu0 0x34 0x10>;
			clocks = <&pmu PMU_GATE_USB1_CTRL>,
				 <&pmu PMU_GATE_USB1_PHY>;
			clock-names = "ctrl", "phy";
			vbus-gpios = <&gpio 33 GPIO_ACTIVE_HIGH>;
			resets = <&rcu 0x3c 0>, <&rcu 0x48 5>;
			reset-names = "analog-config", "statemachine-soft";
		};
	};
```

## Documentation/devicetree/bindings/phy/phy-xway-usb2.txt
```
lantiq xway Soc USB 1.1/2.0 PHY binding
=======================================

This binding describes a device that is used to control the USB PHY hardware.

Required properties (controller (parent) node):
- compatible	: Should be one of
			"lantiq,arx100-usb2-phy"
			"lantiq,arx300-usb2-phy"
			"lantiq,ase-usb2-phy"
			"lantiq,danube-usb2-phy"
			"lantiq,grx390-usb2-phy"
			"lantiq,vrx200-usb2-phy"
			"lantiq,xway-usb2-phy"
- address-cells	: should be 1
- size-cells	: should be 0
- phy-cells	: from the generic PHY bindings, must be 1

Required nodes	:  A sub-node is required for each USB PHY.

Required properties (port (child) node):
- reg        	: The ID of the USB port, usually 0 or 1.
- clocks	: References to the (PMU) "ctrl" and "phy" clk gates.
- clock-names	: Must be one of the following:
			"ctrl"
			"phy"
- resets	: References to the RCU USB configuration resets.
- reset-names	: Must be one of the following:
			"config"
			"hostmode"
			"slave-endianness"
			"host-endianness"
			"statemachine-hard"
			"statemachine-soft"

Optional properties (port (child) node):
- vbus-gpio	: References a GPIO which enables VBUS for the USB port.

Example:

	usb_phys: xway-usb2-phy {
		compatible      = "lantiq,xway-usb2-phy";
		#address-cells	= <1>;
		#size-cells	= <0>;
		#phy-cells	= <1>;

		usb0_phy: port@0 {
			reg = <0>;

			clocks = <&pmu PMU_GATE_USB0_CTRL>,
				 <&pmu PMU_GATE_USB0_PHY>;
			clock-names = "ctrl", "phy";
			vbus-gpio = <&gpio 32>;
			resets = <&rcu 0x38 0>, <&rcu 0x18 11>, <&rcu 0x18 9>,
					<&rcu 0x18 10>, <&rcu 0x10 4>,
					<&rcu 0x48 4>
			reset-names = "config", "hostmode", "slave-endianness",
					"host-endianness", "statemachine-hard",
					"statemachine-soft"
		};

		usb1_phy: port@1 {
			reg = <0>;

			clocks = <&pmu PMU_GATE_USB1_CTRL>,
				 <&pmu PMU_GATE_USB1_PHY>;
			clock-names = "ctrl", "phy";
			resets = <&rcu 0x3c 0>, <&rcu 0x34 11>, <&rcu 0x34 9>,
					<&rcu 0x34 10>, <&rcu 0x10 4>,
					<&rcu 0x48 5>
			reset-names = "config", "hostmode", "slave-endianness",
					"host-endianness", "statemachine-hard",
					"statemachine-soft"
		};
	};
```

## Documentation/devicetree/bindings/power/reset/gpio-poweroff.txt
```
Driver a GPIO line that can be used to turn the power off.

The driver supports both level triggered and edge triggered power off.
At driver load time, the driver will request the given gpio lines and
install a handler to power off the system. If the optional properties
'input' is not found, the GPIO line will be driven in the inactive
state. Otherwise its configured as an input.

When the power-off handler is called, the gpios are configured as an
output, and drive active, so triggering a level triggered power off
condition. This will also cause an inactive->active edge condition, so
triggering positive edge triggered power off. After a delay of 100ms,
the GPIOs are set to inactive, thus causing an active->inactive edge,
triggering negative edge triggered power off. After another 100ms
delay the GPIO is driver active again. If the power is still on and
the CPU still running after a 3000ms delay, a WARN_ON(1) is emitted.

Required properties:
- compatible : should be "gpio-poweroff".
- gpios : The GPIOs (one or more) to set high/low, see "gpios property" in
  Documentation/devicetree/bindings/gpio/gpio.txt. If the pins should be
  low to power down the board set it to "Active Low", otherwise set the
  gpios to "Active High".

Optional properties:
- input : Initially configure the GPIO lines as an input. Only reconfigure
  them to an output when the power-off handler is called. If this optional
  property is not specified, the GPIOs are initialized as an output in its
  inactive state.
- timeout-ms: Time to wait before asserting a WARN_ON(1). If nothing is
              specified, 3000 ms is used.

Examples:

gpio-poweroff {
	compatible = "gpio-poweroff";
	gpios = <&gpio 4 0>;
	timeout-ms = <3000>;
};
```

## Documentation/devicetree/bindings/pwm/pwm-meson.txt
```
Amlogic Meson PWM Controller
============================

Required properties:
- compatible: Depending on the SoC, this should be one of:
	- "amlogic,meson8-pwm" on Meson8 SoCs
	- "amlogic,meson8b-pwm" on Meson8b SoCs
	- "amlogic,meson8m2-pwm" on Meson8m2 SoCs
	- "amlogic,meson-gxbb-pwm" on Meson GXBB SoCs
- #pwm-cells: Should be 3. See pwm.txt in this directory for a description of
  the cells format.

Optional properties:
- clocks: Could contain one or two parents clocks phandle for each of the two
  PWM channels.
- clock-names: Could contain at least the "clkin0" and/or "clkin1" names.

Example:

	pwm_ab: pwm@8550 {
		compatible = "amlogic,meson-gxbb-pwm";
		reg = <0x0 0x08550 0x0 0x10>;
		#pwm-cells = <3>;
		status = "disabled";
		clocks = <&xtal>, <&xtal>;
		clock-names = "clkin0", "clkin1";
	}
```

## Documentation/devicetree/bindings/remoteproc/amlogic,meson-ao-arc-rproc.yaml
```yaml
# SPDX-License-Identifier: (GPL-2.0-only OR BSD-2-Clause)
%YAML 1.2
---
$id: "http://devicetree.org/schemas/remoteproc/amlogic,meson-ao-arc-rproc.yaml#"
$schema: "http://devicetree.org/meta-schemas/core.yaml#"

title: Amlogic Meson AO ARC Remote Processor bindings

description:
  Amlogic Meson6, Meson8, Meson8b and Meson8m2 SoCs embed an ARC EM4
  controller for always-on operations, typically used for managing
  system suspend.

maintainers:
  - Martin Blumenstingl <martin.blumenstingl@googlemail.com>

properties:
  compatible:
    const: amlogic,meson-ao-arc-rproc

  firmware-name:
    $ref: /schemas/types.yaml#/definitions/string
    description:
      The name of the firmware which should be loaded for this remote
      processor.

  reg:
    description:
      Address ranges of the remap, status and CPU control/status memories
      used by the remote processor.
    maxItems: 3

  reg-names:
    items:
      - const: status
      - const: remap
      - const: cpu

  resets:
     maxItems: 1

required:
  - compatible
  - reg
  - reg-names
  - resets

additionalProperties: false

examples:
  - |
    remoteproc@0 {
      compatible= "amlogic,meson-ao-arc-rproc";
      reg = <0x0 0xc>, <0x1c 0x8>, <0x38 0x8>;
      reg-names = "status", "remap", "cpu";
      resets = <&media_cpu_reset>;
    };

...
```

## Documentation/devicetree/bindings/remoteproc/amlogic,meson-mx-ao-arc-rproc.yaml
```yaml
# SPDX-License-Identifier: (GPL-2.0-only OR BSD-2-Clause)
%YAML 1.2
---
$id: "http://devicetree.org/schemas/remoteproc/amlogic,meson-mx-ao-arc-rproc.yaml#"
$schema: "http://devicetree.org/meta-schemas/core.yaml#"

title: Amlogic Meson AO ARC Remote Processor bindings

description:
  Amlogic Meson6, Meson8, Meson8b and Meson8m2 SoCs embed an ARC EM4
  controller for always-on operations, typically used for managing
  system suspend.

maintainers:
  - Martin Blumenstingl <martin.blumenstingl@googlemail.com>

properties:
  compatible:
    const: amlogic,meson-mx-ao-arc-rproc

  firmware-name:
    $ref: /schemas/types.yaml#/definitions/string
    description:
      The name of the firmware which should be loaded for this remote
      processor.

  reg:
    description:
      Address ranges of the remap and CPU control addresses for the
      remote processor.
    minItems: 2

  reg-names:
    items:
      - const: remap
      - const: cpu

  resets:
     minItems: 1

  amlogic,sram:
    $ref: /schemas/types.yaml#/definitions/phandle
    description:
      A phandle to the device SRAM

  amlogic,secbus2:
    $ref: /schemas/types.yaml#/definitions/phandle
    description:
      A phandle to the SECBUS2 region which contains some configuration
      bits of this remote processor

required:
  - compatible
  - reg
  - reg-names
  - resets
  - amlogic,sram
  - amlogic,secbus2

additionalProperties: false

examples:
  - |
    remoteproc@1c {
      compatible= "amlogic,meson-mx-ao-arc-rproc";
      reg = <0x1c 0x8>, <0x38 0x8>;
      reg-names = "remap", "cpu";
      resets = <&media_cpu_reset>;
      amlogic,sram = <&ahb_sram>;
      amlogic,secbus2 = <&secbus2>;
    };

...
```

## Documentation/devicetree/bindings/reset/intel,rcu-gw.yaml
```yaml
# SPDX-License-Identifier: (GPL-2.0 OR BSD-2-Clause)
%YAML 1.2
---
$id: http://devicetree.org/schemas/reset/intel,rcu-gw.yaml#
$schema: http://devicetree.org/meta-schemas/core.yaml#

title: System Reset Controller on Intel Gateway SoCs

maintainers:
  - Dilip Kota <eswara.kota@linux.intel.com>

properties:
  compatible:
    oneOf:
      - items:
          - enum:
              - lantiq,ase-rcu
              - lantiq,danube-rcu
              - lantiq,xrx100-rcu
              - lantiq,xrx200-rcu
          - const: simple-mfd
          - const: syscon
      - const: intel,rcu-lgm

  reg:
    description: Reset controller registers.
    maxItems: 1

  intel,global-reset:
    description: Global reset register offset and bit offset.
    $ref: /schemas/types.yaml#/definitions/uint32-array
    minItems: 2
    items:
      - description: Register offset
      - description: Register bit offset
        minimum: 0
        maximum: 31
      - description: Status bit offset (only if "#reset-cells" is 3)
        minimum: 0
        maximum: 31

  "#reset-cells":
    description: |
      First cell is reset request register offset.
      Second cell is bit offset in reset request register.
      Third cell is bit offset in reset status register.
      For LGM SoC, reset cell count is 2 as bit offset in
      reset request and reset status registers is same. Whereas
      3 for legacy SoCs as bit offset differs.

  "#address-cells":
    const: 1

  "#size-cells":
    const: 1

  big-endian: true

patternProperties:
  "^usb2-phy@[0-9a-f]+$":
    type: object
    $ref: "../phy/lantiq,xway-rcu-usb2-phy.yaml"

allOf:
  - if:
      properties:
        compatible:
          contains:
            const: intel,rcu-lgm
    then:
      properties:
        "#reset-cells":
          const: 2
  - if:
      properties:
        compatible:
          contains:
            enum:
              - lantiq,ase-rcu
              - lantiq,danube-rcu
              - lantiq,xrx100-rcu
              - lantiq,xrx200-rcu
    then:
      properties:
        "#reset-cells":
          const: 3

required:
  - compatible
  - reg
  - intel,global-reset
  - "#reset-cells"

additionalProperties: false

examples:
  - |
    rcu0: reset-controller@e0000000 {
        compatible = "intel,rcu-lgm";
        reg = <0xe0000000 0x20000>;
        intel,global-reset = <0x10 30>;
        #reset-cells = <2>;
    };

    pwm: pwm@e0d00000 {
        compatible = "intel,lgm-pwm";
        reg = <0xe0d00000 0x30>;
        clocks = <&cgu0 1>;
        #pwm-cells = <2>;
        resets = <&rcu0 0x30 21>;
    };
  - |
    rcu_xrx200: rcu@203000 {
        compatible = "lantiq,xrx200-rcu", "simple-mfd", "syscon";
        reg = <0x203000 0x100>;
        big-endian;

        #address-cells = <1>;
        #size-cells = <1>;

        #reset-cells = <3>;
        intel,global-reset = <0x10 30 29>;

        usb_phy0: usb2-phy@18 {
            compatible = "lantiq,xrx200-usb2-phy";
            reg = <0x18 4>, <0x38 4>;
            status = "disabled";

            resets = <&rcu_xrx200 0x48 4 4>, <&rcu_xrx200 0x10 4 4>;
            reset-names = "phy", "ctrl";
            #phy-cells = <0>;
        };

        usb_phy1: usb2-phy@34 {
            compatible = "lantiq,xrx200-usb2-phy";
            reg = <0x34 4>, <0x3c 4>;
            status = "disabled";

            resets = <&rcu_xrx200 0x48 5 5>, <&rcu_xrx200 0x10 4 4>;
            reset-names = "phy", "ctrl";
            #phy-cells = <0>;
        };
    };
```

## Documentation/devicetree/bindings/reset/lantiq,rcu-reset.txt
```
Lantiq XWAY SoC RCU reset controller binding
============================================

This binding describes a reset-controller found on the RCU module on Lantiq
XWAY SoCs.


-------------------------------------------------------------------------------
Required properties (controller (parent) node):
- compatible		: Should be "lantiq,rcu-reset"
- lantiq,rcu-syscon	: A phandle to the RCU syscon, the reset register
			  offset and the status register offset.
- #reset-cells		: Specifies the number of cells needed to encode the
			  reset line, should be 1.

-------------------------------------------------------------------------------
Example for the reset-controllers on the xRX200 SoCs:
	rcu_reset0: rcu_reset {
		compatible = "lantiq,rcu-reset";
		lantiq,rcu-syscon = <&rcu0 0x10 0x14>;
		#reset-cells = <1>;
	};

	rcu_reset1: rcu_reset {
		compatible = "lantiq,rcu-reset";
		lantiq,rcu-syscon = <&rcu0 0x48 0x24>;
		#reset-cells = <1>;
	};
```

## Documentation/devicetree/bindings/reset/lantiq,xway-rcu.txt
```
* Reset controller for Lantiq XWAY SoCs

Please also refer to reset.txt in this directory for common reset
controller binding usage.

The reset controller node must be a sub-node of the sram node on XWAY SoCs.

Required properties:
- compatible: Must be one of the following:
	- "lantiq,rcu-xway" (for pre-xRX200 SoCs)
	- "lantiq,rcu-xrx200" (for xRX200 and newer SoCs)
- reg: Address and length of the register set
- #reset-cells: must be set to 2

Example:

rcu: rcu@203000 {
	compatible = "lantiq,rcu-xway";
	reg = <0x203000 0x1000>;
	#reset-cells = <2>;
};

usb0_phy1 {
	/* RCU offset 0x38 bit 0 and offset 0x18 bit 11: */
	resets = <&rcu 0x38 0>, <&rcu 0x18 11>;
}
```
