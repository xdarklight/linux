## Documentation/devicetree/bindings/net/icplus,ip101ag.yaml
```yaml
# SPDX-License-Identifier: GPL-2.0+
%YAML 1.2
---
$id: http://devicetree.org/schemas/net/icplus,ip101ag.yaml#
$schema: http://devicetree.org/meta-schemas/core.yaml#

title: IC Plus Corp. IP101A / IP101G Ethernet PHYs

maintainers:
  - Andrew Lunn <andrew@lunn.ch>
  - Florian Fainelli <f.fainelli@gmail.com>
  - Martin Blumenstingl <martin.blumenstingl@googlemail.com>

description: |
  Bindings for IC Plus Corp. IP101A / IP101G Ethernet MII/RMII/SMI PHYs

  There are different models of the IP101G Ethernet PHY:
  - IP101GR (32-pin QFN package)
  - IP101G (die only, no package)
  - IP101GA (48-pin LQFP package)

  There are different models of the IP101A Ethernet PHY (which is the
  predecessor of the IP101G):
  - IP101A (48-pin LQFP package)
  - IP101AH (48-pin LQFP package)

  All of them share the same PHY ID.

properties:
  compatible:
    enum:
      - ethernet-phy-id0243.0c54

  clocks:
    maxItems: 1
    description:
      25MHz (crystal or oscillator) or a 50MHz RMII REF_CLK input

  clock-names:
    oneOf:
      - description: 25MHz crystal input
        items:
          - const: xtal
      - description: 25MHz (single-ended) oscillator
        items:
          - const: 25mhz_oscillator
      - description: 50MHz RMII reference clock
        items:
          - const: ref_clk

  '#clock-cells':
    const: 0
    description: |
      The PHY generates a 50MHz RMII REF_CLK (called C50M_O) output when
      supplied with a 25MHz input.

  icplus,select-rx-error:
    type: boolean
    description: |
      Pin 21 ("RXER/INTR_32") will output the receive error status.
      Interrupts are not routed outside the PHY in this mode.

      This is only supported for IP101GR (32-pin QFN package).

  icplus,select-interrupt:
    type: boolean
    description: |
      Pin 21 ("RXER/INTR_32") will output the interrupt signal.

      This is only supported for IP101GR (32-pin QFN package).

# RXER and INTR_32 functions are mutually exclusive
dependentSchemas:
  icplus,select-rx-error:
    properties:
      icplus,select-interrupt: false
  icplus,select-interrupt:
    properties:
      icplus,select-rx-error: false

allOf:
  - $ref: ethernet-phy.yaml#
  - if:
      properties:
        clock-names:
          contains:
            const: ref_clk
      then:
        '#clock-cells': false

unevaluatedProperties: false

examples:
  - |
    mdio {
        #address-cells = <1>;
        #size-cells = <0>;

        ethphy1: ethernet-phy@1 {
                reg = <1>;
                icplus,select-interrupt;
        };
    };
```

## Documentation/devicetree/bindings/net/smsc,lan87xx.yaml
```yaml
# SPDX-License-Identifier: GPL-2.0+
%YAML 1.2
---
$id: http://devicetree.org/schemas/net/smsc,lan87xx.yaml#
$schema: http://devicetree.org/meta-schemas/core.yaml#

title: SMSC / Microchip LAN87xx PHY

maintainers:
  - Andrew Lunn <andrew@lunn.ch>
  - Florian Fainelli <f.fainelli@gmail.com>

description:
  Bindings for SMSC / Microchip LAN87xx PHYs

allOf:
  - $ref: ethernet-phy.yaml#

properties:
  compatible:
    enum:
      - ethernet-phy-id0007.c0a0 # LAN83C185
      - ethernet-phy-id0007.c0b0 # LAN8187
      - ethernet-phy-id0007.c0c0 # LAN8700
      - ethernet-phy-id0007.c0c3 # LAN8700
      - ethernet-phy-id0007.c0d0 # LAN911x Internal PHY
      - ethernet-phy-id0007.c0f0 # LAN8710/LAN8720
      - ethernet-phy-id0007.c0f1 # LAN8710/LAN8720
      - ethernet-phy-id0007.c110 # LAN8740
      - ethernet-phy-id0007.c130 # LAN8742
      - ethernet-phy-id0007.c131 # LAN8742

  clocks:
    maxItems: 1
    description: |
      The clock used as phy reference clock and is connected to phy
      pin XTAL1/CLKIN.

  smsc,disable-energy-detect:
    type: boolean
    description: |
      If set, do not enable energy detect mode for the SMSC PHY.
      default: enable energy detect mode

unevaluatedProperties: false

examples:
  - |
    mdio {
        #address-cells = <1>;
        #size-cells = <0>;

        ethernet-phy@1 {
            reg = <1>;
            clock = <&phy_clk_in>;
        };

        ethernet-phy@2 {
            reg = <2>;
            smsc,disable-energy-detect;
        };
    };
```

## Documentation/devicetree/bindings/opp/amlogic,meson-s4-cpu-operating-points.yaml
```yaml
# SPDX-License-Identifier: GPL-2.0
%YAML 1.2
---
$id: http://devicetree.org/schemas/opp/amlogic,meson-s4-cpu-operating-points.yaml#
$schema: http://devicetree.org/meta-schemas/core.yaml#

title: Amlogic Meson-S4 CPU OPP

maintainers:
  - Martin Blumenstingl <martin.blumenstingl@googlemail.com>

description: |
  On Amlogic Meson-S4 SoCs the voltages of the CPU OPPs depend on the
  silicon quality. The secure monitor firmware exposes the silicon
  binning information, where higher bins are of better silicon quality
  (meaning: the same frequency requires lower operating voltages).

allOf:
  - $ref: opp-v2-base.yaml#

properties:
  compatible:
    const: amlogic,meson-s4-cpu-operating-points

  secure-monitor:
    description: phandle to the secure-monitor node
    $ref: /schemas/types.yaml#/definitions/phandle

  opp-shared: true

required:
  - compatible

patternProperties:
  "^opp-[0-9]+$":
    type: object

    properties:
      opp-hz: true
      clock-latency-ns: true
      opp-microvolt: true

    patternProperties:
      "^opp-microvolt-bin[0-9]$": true

    required:
      - opp-hz

    unevaluatedProperties: false

additionalProperties: false

examples:
  - |
    cpu_opp_table: opp-table {
        compatible = "amlogic,meson-s4-cpu-operating-points";
        secure-monitor = <&sm>;
        opp-shared;

        opp-100000000 {
            opp-hz = /bits/ 64 <100000000>;
            opp-microvolt-bin0 = <769000>;
            opp-microvolt-bin1 = <769000>;
            opp-microvolt-bin2 = <759000>;
            opp-microvolt-bin3 = <759000>;
            clock-latency-ns = <50000>;
        };

        opp-1800000000 {
            opp-hz = /bits/ 64 <1704000000>;
            opp-microvolt-bin0 = <1009000>;
            opp-microvolt-bin1 = <1009000>;
            opp-microvolt-bin2 = <999000>;
            opp-microvolt-bin3 = <939000>;
            clock-latency-ns = <50000>;
        };
    };
```
