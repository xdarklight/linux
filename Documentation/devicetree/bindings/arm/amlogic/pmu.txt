## Documentation/devicetree/bindings/mips/lantiq/rcu-sys-status.txt
```
Lantiq XWAY SoC System Status binding
=====================================

This binding describes a the system status functionality provided by the RCU
module on Lantiq XWAY SoCs.


-------------------------------------------------------------------------------
Required properties (controller (parent) node):
- compatible		: Should be one of
				"lantiq,ase-rcu-sys-status"
				"lantiq,danube-rcu-sys-status"
				"lantiq,xrx100-rcu-sys-status"
				"lantiq,xrx200-rcu-sys-status"
				"lantiq,xrx300-rcu-sys-status"
- lantiq,rcu-syscon	: A phandle and offset to the system status registers
			  in the RCU module


-------------------------------------------------------------------------------
Example:
	rcu_sys_status: rcu_sys_status {
		compatible = "lantiq,xrx200-rcu-sys-status";
		lantiq,rcu-syscon = <&rcu0 0x14>;
	};
```

## Documentation/devicetree/bindings/mips/lantiq/rcu.txt
```
Lantiq XWAY SoC RCU binding
===========================

This binding describes the RCU (reset controller unit) multifunction device,
where each sub-device has it's own set of registers.


-------------------------------------------------------------------------------
Required properties:
- compatible	: The first and second values must be: "simple-mfd", "syscon"
- reg		: The address and length of the system control registers


-------------------------------------------------------------------------------
Example of the RCU bindings on a xRX200 SoC:
	rcu0: rcu@203000 {
		compatible = "simple-mfd", "syscon";
		reg = <0x203000 0x1000>;

		rcu_sys_status {
			compatible = "lantiq,xrx200-rcu-sys-status";
			lantiq,rcu-syscon = <&rcu0 0x14>;
		};

		gphy0: rcu_gphy {
			compatible = "lantiq,xrx200-rcu-gphy";
			lantiq,rcu-syscon = <&rcu0 0x20>;
			resets = <&rcu_reset0 31>;
			reset-names = "gphy";
			lantiq,gphy-mode = <GPHY_MODE_GE>;
			clocks = <&pmu0 XRX200_PMU_GATE_GPHY>;
			clock-names = "gphy";
		};

		gphy1: rcu_gphy {
			compatible = "lantiq,xrx200-rcu-gphy";
			lantiq,rcu-syscon = <&rcu0 0x68>;
			resets = <&rcu_reset0 29>;
			reset-names = "gphy";
			lantiq,gphy-mode = <GPHY_MODE_FE>;
			clocks = <&pmu0 XRX200_PMU_GATE_GPHY>;
			clock-names = "gphy";
		};

		rcu_reset0: rcu_reset {
			compatible = "lantiq,rcu-reset";
			lantiq,rcu-syscon = <&rcu0 0x10 0x14>;
			#reset-cells = <1>;
		};

		rcu_reset1: rcu_reset {
			compatible = "lantiq,rcu-reset";
			lantiq,rcu-syscon = <&rcu0 0x48 0x24>;
			#reset-cells = <1>;
		};

		/* more sub-device nodes (USB PHY, etc.) */
	};
```

## Documentation/devicetree/bindings/mips/lantiq/xbar.txt
```
Lantiq XWAY SoC XBAR binding
============================


-------------------------------------------------------------------------------
Required properties:
- compatible	: Should be "lantiq,xbar-xway"
- reg		: The address and length of the XBAR registers

Optional properties:
- lantiq,rcu-syscon	: A phandle and offset to the endianess configuration
			  registers in the RCU module


-------------------------------------------------------------------------------
Example for the XBAR on the xRX200 SoCs:
	xbar0: xbar@400000 {
			compatible = "lantiq,xbar-xway";
			reg = <0x400000 0x1000>;
			lantiq,rcu-syscon = <&rcu0 0x4c>;
	};
```

## Documentation/devicetree/bindings/mmc/amlogic,meson-mx-sdhc.txt
```
* Amlogic Meson6, Meson8, Meson8b and Meson8m2 SDHC controller

The SDHC MMC host controller on Amlogic SoCs provides an eMMC and MMC
card interface with 1/4/8-bit bus width.
It supports eMMC spec 4.4x/4.5x including HS200 (up to 100MHz clock).

This file documents the properties in addition to those available in
the MMC core bindings, documented by mmc.txt.

Required properties:
 - compatible : must be one of
	- "amlogic,meson8-sdhc"
	- "amlogic,meson8b-sdhc"
	- "amlogic,meson8m2-sdhc"
	preceded by the generic "amlogic,meson-mx-sdhc"
 - reg : register base address and size
 - interrupts : SDHC controller interrupt
 - clocks : phandle to clock providers
 - clock-names : "pclk", "clkin0", "clkin1", "clkin2" and "clkin3"
		 ("pclk" is the module gate clock, and clkin are
		  the inputs to the internal clock mux)

Examples:
	mmc@8e00 {
		compatible = "amlogic,meson8-sdhc", "amlogic,meson-mx-sdhc";
		reg = <0x8e00 0x42>;
		interrupts = <GIC_SPI 78 IRQ_TYPE_EDGE_RISING>;
		clocks = <&clkc CLKID_SDHC>,
			<&clkc CLKID_XTAL>,
			<&clkc CLKID_FCLK_DIV4>,
			<&clkc CLKID_FCLK_DIV3>,
			<&clkc CLKID_FCLK_DIV5>;
		clock-names = "pclk", "clkin0", "clkin1", "clkin2", "clkin3";
	};
```

## Documentation/devicetree/bindings/mmc/amlogic,meson-mx-sdhc.yaml
```yaml
# SPDX-License-Identifier: (GPL-2.0-only OR BSD-2-Clause)
%YAML 1.2
---
$id: http://devicetree.org/schemas/mmc/amlogic,meson-mx-sdhc.yaml#
$schema: http://devicetree.org/meta-schemas/core.yaml#

title: Amlogic Meson SDHC controller Device Tree Bindings

allOf:
  - $ref: "mmc-controller.yaml"

maintainers:
  - Martin Blumenstingl <martin.blumenstingl@googlemail.com>

description: |
  The SDHC MMC host controller on Amlogic SoCs provides an eMMC and MMC
  card interface with 1/4/8-bit bus width.
  It supports eMMC spec 4.4x/4.5x including HS200 (up to 100MHz clock).

properties:
  compatible:
    items:
      - enum:
        - amlogic,meson8-sdhc
        - amlogic,meson8b-sdhc
        - amlogic,meson8m2-sdhc
      - const: amlogic,meson-mx-sdhc

  reg:
    minItems: 1

  interrupts:
    minItems: 1

  "#clock-cells":
    const: 1

  clocks:
    minItems: 9

  clock-names:
    items:
      - const: clkin0
      - const: clkin1
      - const: clkin2
      - const: clkin3
      - const: pclk
      - const: mod_clk
      - const: sd_clk
      - const: tx_clk
      - const: rx_clk

required:
  - compatible
  - reg
  - interrupts
  - "#clock-cells"
  - clocks
  - clock-names

examples:
  - |
    #include <dt-bindings/clock/meson-mx-sdhc-clkc.h>
    #include <dt-bindings/interrupt-controller/irq.h>
    #include <dt-bindings/interrupt-controller/arm-gic.h>

    sdhc: mmc@8e00 {
      compatible = "amlogic,meson8-sdhc", "amlogic,meson-mx-sdhc";
      reg = <0x8e00 0x42>;
      interrupts = <GIC_SPI 78 IRQ_TYPE_EDGE_RISING>;
      #clock-cells = <1>;
      clocks = <&xtal>,
               <&fclk_div4>,
               <&fclk_div3>,
               <&fclk_div5>,
               <&sdhc_pclk>,
               <&sdhc SDHC_CLKID_MOD_CLK>,
               <&sdhc SDHC_CLKID_SD_CLK>,
               <&sdhc SDHC_CLKID_TX_CLK>,
               <&sdhc SDHC_CLKID_RX_CLK>;
      clock-names = "clkin0", "clkin1", "clkin2", "clkin3", "pclk",
                    "mod_clk", "sd_clk", "tx_clk", "rx_clk";
    };
```

## Documentation/devicetree/bindings/mmc/amlogic,meson-mx.txt
```
* Amlogic Meson6, Meson8 and Meson8b MMC controller

The highspeed MMC host controller on Amlogic SoCs provides an interface
for MMC, SD, SDIO and SDHC types of memory cards.

Supported maximum speeds are the ones of the eMMC standard 4.41 as well
as the speed of SD standard 2.0.

The hardware provides an internal "mux" which allows up to three slots
to be controlled. Only one device can be accessed at a time.

Required properties:
 - compatible : must be one of
	- "amlogic,meson8-mmc"
	- "amlogic,meson8b-mmc"
	along with the generic "amlogic,meson-mx-mmc"
 - reg : mmc controller base registers
 - interrupts : mmc controller interrupt
 - #address-cells : must be 1
 - size-cells : must be 0
 - clocks : phandle to clock providers
 - clock-names : must contain "core" and "clkin"

Required child nodes:
A node for each slot provided by the MMC controller is required.

Required properties on each child node (= slot):
 - reg : the slot (or "port") ID

Optional properties on each child node (= slot):
 - bus-width : must be 1 or 4 (8-bit bus is not supported)
 - for cd and all other additional generic mmc parameters
   please refer to mmc.txt within this directory

Examples:
	mmc0: mmc@c1108c20 {
		compatible = "amlogic,meson8-mmc", "amlogic,meson-mx-mmc";
		reg = <0xc1108c20 0x20>;
		interrupts = <0 28 1>;
		#address-cells = <1>;
		#size-cells = <0>;
		clocks = <&clkc CLKID_SDIO>, <&clkc CLKID_CLK81>;
		clock-names = "core", "clkin";

		slot@1 {
			reg = <1>;

			bus-width = <4>;
		};
	};
```

## Documentation/devicetree/bindings/mtd/amlogic,meson-nand.txt
```
Amlogic NAND Flash Controller (NFC)

Amlogic NAND Flash Controller for S905/GXBB/AXG family SoCs


This file documents the properties in addition to those available in
the MTD NAND bindings.

Required properties:
- compatible : contains one of:
  - "amlogic,meson-gxl-nfc"
  - "amlogic,meson-axg-nfc"


Example:

		&nand {
			status = "okay";
			#address-cells = <1>;
			#size-cells = <0>;
			pinctrl-names = "default";
			pinctrl-0 = <&nand_pins>;
			nand@0 {
				reg = <0>;
				nand-on-flash-bbt;
				nand-ecc-mode = "hw";
				nand-ecc-strength = <8>;
				nand-ecc-step-size = <1024>;
			};
		};

		&nand {
			clocks = <&clkc CLKID_NAND>,
				 <&clkc CLKID_FCLK_DIV2>,
				 <&clkc CLKID_SD_EMMC_C_CLK0>,
				 <&clkc CLKID_SD_EMMC_C_CLK0_SEL>;
			clock-names = "mod_gate", "clk_master", "clk_nand", "clk_sel";
		};

		&pinctrl_periphs {
			nand_pins: nand {
				mux {
					groups = "emmc_nand_d07",
						"nand_ce0",
						"nand_ce1",
						"nand_rb0",
						"nand_ale",
						"nand_cle",
						"nand_wen_clk",
						"nand_ren_wr",
						"nand_dqs";
					function = "nand";
				};
			};

		};
```

## Documentation/devicetree/bindings/mtd/intel,lgm-nand.yaml
```yaml
# SPDX-License-Identifier: (GPL-2.0 OR BSD-2-Clause)
%YAML 1.2
---
$id: http://devicetree.org/schemas/mtd/intel,lgm-ebunand.yaml#
$schema: http://devicetree.org/meta-schemas/core.yaml#

title: Intel LGM SoC NAND Controller Device Tree Bindings

maintainers:
  - Ramuthevar Vadivel Murugan <vadivel.muruganx.ramuthevar@linux.intel.com>

properties:
  compatible:
    enum:
      - intel,lgm-ebunand
      - lantiq,danube-ebunand
      - lantiq,xrx100-ebunand
      - lantiq,xrx200-ebunand
      - lantiq,xrx300-ebunand

  reg:
    minItems: 5
    maxItems: 6

  reg-names:
    items:
      - const: ebunand
      - const: hsnand
      - const: nand_cs0
      - const: nand_cs1
      - const: addr_sel0
      - const: addr_sel1

  clocks:
    maxItems: 1

  dmas:
    maxItems: 2

  dma-names:
    items:
      - const: tx
      - const: rx

  "#address-cells":
    const: 1

  "#size-cells":
    const: 0

allOf:
  - $ref: "nand-controller.yaml"

  - if:
      properties:
        compatible:
          contains:
            const: intel,lgm-ebunand
    then:
      required:
        - dmas
        - dma-names

patternProperties:
  "^nand@[a-f0-9]+$":
    type: object
    properties:
      reg:
        minimum: 0
        maximum: 1

required:
  - compatible
  - reg
  - reg-names
  - clocks
  - "#address-cells"
  - "#size-cells"

additionalProperties: false

examples:
  - |
    nand-controller@e0f00000 {
      compatible = "intel,lgm-ebunand";
      reg = <0xe0f00000 0x100>,
            <0xe1000000 0x300>,
            <0xe1400000 0x8000>,
            <0xe1c00000 0x1000>,
            <0x17400000 0x4>,
            <0x17c00000 0x4>;
      reg-names = "ebunand", "hsnand", "nand_cs0", "nand_cs1",
        "addr_sel0", "addr_sel1";
      clocks = <&cgu0 125>;
      dmas = <&dma0 8>, <&dma0 9>;
      dma-names = "tx", "rx";
      #address-cells = <1>;
      #size-cells = <0>;

      nand@0 {
        reg = <0>;
        nand-ecc-mode = "hw";
      };
    };
  - |
    nand-controller@e1053b0 {
      compatible = "lantiq,xrx300-ebunand";
      reg = <0xe1053b0 0x14>,
            <0x0 0x1000>,
            <0x4000000 0x1000>,
            <0x0 0x4>,
            <0x4000000 0x4>;
      reg-names = "ebunand", "nand_cs0", "nand_cs1", "addr_sel0", "addr_sel1";
      #address-cells = <1>;
      #size-cells = <0>;

      nand@0 {
        reg = <0>;
        nand-ecc-mode = "soft";
      };
    };

...
```
