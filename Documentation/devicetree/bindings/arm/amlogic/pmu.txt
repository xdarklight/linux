## Documentation/devicetree/bindings/mtd/mediatek,nfc.yaml
```yaml
# SPDX-License-Identifier: (GPL-2.0-only OR BSD-2-Clause)
%YAML 1.2
---
$id: http://devicetree.org/schemas/mtd/mediatek,nfc.yaml#
$schema: http://devicetree.org/meta-schemas/core.yaml#

title: Mediatek NAND Flash Controller

maintainers:
  - Weijie Gao <weijie.gao@mediatek.com>
  - Jorge Ramirez-Ortiz <jorge.ramirez-ortiz@linaro.org>

properties:
  compatible:
    enum:
      - mediatek,mt2701-nfc
      - mediatek,mt2712-nfc
      - mediatek,mt7621-nfc
      - mediatek,mt7622-nfc

  reg:
    maxItems: 1

  clocks:
    minItems: 1
    maxItems: 2

  clock-names:
    minItems: 1
    maxItems: 2
    items:
      - const: nfi_clk
      - const: pad_clk

  interrupts:
    maxItems: 1

  ecc-engine: true
  "#address-cells": true
  "#size-cells": true

patternProperties:
  "^nand@[a-f0-9]$":
    type: object
    properties:
      nand-ecc-strength:
        description: |+
          The strength should be calculated as follows:
          E = (S - F) * 8 / B
          S = O / (P / Q)
            E : nand-ecc-strength.
            S : spare size per sector.
            F : FDM size, should be in the range [1,8].
                It is used to store free oob data.
            O : oob size.
            P : page size.
            Q : nand-ecc-step-size.
            B : number of parity bits needed to correct 1 bitflip.
                According to MTK NAND controller design, this number
                depends on max ecc step size that MTK NAND controller
                supports.
                If max ecc step size supported is 1024, then it
                should be always 14. And if max ecc step size is 512,
                then it should be always 13.
                If the result does not match any one of the listed
                choices below, please select the smaller valid value
                from the list.
                (otherwise the driver will do the adjustment at runtime)

      nand-ecc-step-size:
        description: |+
          1024 is recommended for large page NANDs.

allOf:
  - $ref: "nand-controller.yaml#"

  - if:
      properties:
        compatible:
          contains:
            enum:
              - mediatek,mt2701-nfc
              - mediatek,mt2712-nfc
              - mediatek,mt7622-nfc
    then:
      required:
        - interrupts

  - if:
      properties:
        compatible:
          contains:
            const: mediatek,mt2701-nfc
    then:
      patternProperties:
        "^nand@[a-f0-9]$":
          properties:
            nand-ecc-step-size:
              enum:
                - 512
                - 1024
            nand-ecc-strength:
              enum:
                - 4
                - 6
                - 8
                - 10
                - 12
                - 14
                - 16
                - 18
                - 20
                - 22
                - 24
                - 28
                - 32
                - 36
                - 40
                - 44
                - 48
                - 52
                - 56
                - 60

  - if:
      properties:
        compatible:
          contains:
            const: mediatek,mt2712-nfc
    then:
      patternProperties:
        "^nand@[a-f0-9]$":
          properties:
            nand-ecc-step-size:
              enum:
                - 512
                - 1024
            nand-ecc-strength:
              enum:
                - 4
                - 6
                - 8
                - 10
                - 12
                - 14
                - 16
                - 18
                - 20
                - 22
                - 24
                - 28
                - 32
                - 36
                - 40
                - 44
                - 48
                - 52
                - 56
                - 60
                - 68
                - 72
                - 80

  - if:
      properties:
        compatible:
          contains:
            const: mediatek,mt7621-nfc
    then:
      patternProperties:
        "^nand@[a-f0-9]$":
          properties:
            nand-ecc-step-size:
              const: 512
            nand-ecc-strength:
              enum:
                - 4
                - 6
                - 8
                - 10
                - 12

  - if:
      properties:
        compatible:
          contains:
            const: mediatek,mt7622-nfc
    then:
      patternProperties:
        "^nand@[a-f0-9]$":
          properties:
            nand-ecc-step-size:
              const: 512
            nand-ecc-strength:
              enum:
                - 4
                - 6
                - 8
                - 10
                - 12
                - 14
                - 16

required:
  - compatible
  - reg
  - clocks
  - clock-names
  - ecc-engine

additionalProperties: false

examples:
  - |
    nand-controller@1100d000 {
      compatible = "mediatek,mt2701-nfc";
      reg = <0x1100d000 0x1000>;
      interrupts = <56>;
      clocks = <&nfi_clk>, <&nfi_pad_clk>;
      clock-names = "nfi_clk", "pad_clk";
      ecc-engine = <&mtk_nfi_ecc>;
      #address-cells = <1>;
      #size-cells = <0>;
    };
  - |
    nand-controller@1e003000 {
      compatible = "mediatek,mt7621-nfc";
      reg = <0x1e003000 0x800>;
      clocks = <&nficlock>;
      clock-names = "nfi_clk";
      ecc-engine = <&mtk_nfi_ecc>;
      #address-cells = <1>;
      #size-cells = <0>;
    };
...
```

## Documentation/devicetree/bindings/mtd/mediatek,nfiecc.yaml
```yaml
# SPDX-License-Identifier: (GPL-2.0-only OR BSD-2-Clause)
%YAML 1.2
---
$id: http://devicetree.org/schemas/mtd/mediatek,nfiecc.yaml#
$schema: http://devicetree.org/meta-schemas/core.yaml#

title: Mediatek NAND Flash Interface ECC engine

maintainers:
  - Weijie Gao <weijie.gao@mediatek.com>
  - Jorge Ramirez-Ortiz <jorge.ramirez-ortiz@linaro.org>

properties:
  compatible:
    enum:
      - mediatek,mt2701-ecc
      - mediatek,mt2712-ecc
      - mediatek,mt7621-ecc
      - mediatek,mt7622-ecc

  reg:
    maxItems: 1

  clocks:
    maxItems: 1

  clock-names:
    items:
      - const: nfiecc_clk

  interrupts:
    maxItems: 1

allOf:
  - if:
      properties:
        compatible:
          contains:
            enum:
              - mediatek,mt2701-ecc
              - mediatek,mt2712-ecc
              - mediatek,mt7622-ecc
    then:
      required:
        - interrupts

required:
  - compatible
  - reg
  - clocks
  - clock-names

additionalProperties: false

examples:
  - |
    ecc@1100e000 {
      compatible = "mediatek,mt2701-ecc";
      reg = <0x1100e000 0x1000>;
      interrupts = <55>;
      clocks = <&nfi_ecc_clk>;
      clock-names = "nfiecc_clk";
    };
  - |
    ecc@1e003800 {
      compatible = "mediatek,mt7621-ecc";
      reg = <0x1e003800 0x800>;
      clocks = <&nfi_clk>;
      clock-names = "nfiecc_clk";
    };

...
```

## Documentation/devicetree/bindings/net/realtek,rtl8211f.yaml
```yaml
# SPDX-License-Identifier: (GPL-2.0 OR BSD-2-Clause)
%YAML 1.2
---
$id: "http://devicetree.org/schemas/net/realtek,rtl8211f.yaml#"
$schema: "http://devicetree.org/meta-schemas/core.yaml#"

title: Realtek RTL8211F Ethernet PHY

maintainers:
  - Martin Blumenstingl <martin.blumenstingl@googlemail.com>

description: |
  The Realtek RTL8211F-CG/RTL8211FI-CG is a highly integrated Ethernet
  transceiver that is compatible with 10Base-T, 100Base-TX, and 1000Base-T
  IEEE 802.3 standards. It provides all the necessary physical layer
  functions to transmit and receive Ethernet packets over CAT.5 UTP cable.
  The RTL8211FI-CG is manufactured to industrial grade standards.

  The RTL8211F(I)-CG uses state-of-the-art DSP technology and an Analog
  Front End (AFE) to enable high-speed data transmission and reception over
  UTP cable. Functions such as Crossover Detection & Auto-Correction,
  polarity correction, adaptive equalization, cross-talk cancellation,
  echo cancellation, timing recovery, and error correction are implemented
  in the RTL8211F(I)-CG to provide robust transmission and reception
  capabilities at 10Mbps, 100Mbps, or 1000Mbps.

  Data transfer between MAC and PHY is via the Reduced Gigabit Media
  Independent Interface (RGMII) for 1000Base-T, 10Base-T, and 100Base-TX.
  The RTL8211F(I)-CG supports various RGMII signaling voltages, including
  3.3V, 2.5V, 1.8V, and 1.5V.

  The RTL8211F(I)-CG incorporates a state-of-the-art switching regulator that
  requires a well-designed PCB layout in order to achieve good power efficiency
  and lower the output voltage ripple and input overshoot.

allOf:
  - $ref: ethernet-phy.yaml#

properties:
  realtek,led-0-mode:
    $ref: /schemas/types.yaml#definitions/uint32
    description: |
       LED0 configuration; see the RTL8211F_LED_* values from
       <dt-bindings/net/realtek-rtl8211f.h>

  realtek,led-1-mode:
    $ref: /schemas/types.yaml#definitions/uint32
    description: |
       LED1 configuration; see the RTL8211F_LED_* values from
       <dt-bindings/net/realtek-rtl8211f.h>

  realtek,led-2-mode:
    $ref: /schemas/types.yaml#definitions/uint32
    description: |
       LED2 configuration; see the RTL8211F_LED_* values from
       <dt-bindings/net/realtek-rtl8211f.h>

required:
  - reg

examples:
  - |
    #include <dt-bindings/net/realtek-rtl8211f.h>

    mdio {
      #address-cells = <1>;
      #size-cells = <0>;

      ethernet-phy@0 {
        reg = <0>;
        realtek,led-0-mode = <0>;
        realtek,led-1-mode = <(RTL8211F_LED_LINK_100 | RTL8211F_LED_ACTIVITY | RTL8211F_LED_EEE)>;
        realtek,led-2-mode = <(RTL8211F_LED_LINK_1000 | RTL8211F_LED_ACTIVITY | RTL8211F_LED_EEE)>;
      };
    };
```

## Documentation/devicetree/bindings/net/realtek-bluetooth.txt
```
Realtek Bluetooth Chips
-----------------------

This documents the binding structure and common properties for serial
attached Realtek devices.

Serial attached Realtek devices shall be a child node of the host UART
device the slave device is attached to. See ../serial/slave-device.txt
for more information

Required properties:
- compatible: should contain one of the following:
    * "realtek,rtl8723bs-bluetooth"
    * "realtek,rtl8723ds-bluetooth"

Optional properties:
- disable-gpios: GPIO specifier, used to enable/disable the BT module
- reset-gpios: GPIO specifier, used to reset the BT module


Example:

&uart {
	...

	bluetooth {
		compatible = "realtek,rtl8723bs-bluetooth";
		disable-gpios = <&gpio 20 GPIO_ACTIVE_LOW>;
		reset-gpios = <&gpio 11 GPIO_ACTIVE_HIGH>;
	};
};
```

## Documentation/devicetree/bindings/net/wireless/ieee80211.txt
```
The following properties are common to the IEEE 802.11 controllers:

- enable-ieee80211-2ghz: indicates that the 2.4GHz frequency band should be
  enabled for this device. This must not be used together with the
  "disable-ieee80211-2ghz" at the same time.
- enable-ieee80211-5ghz: indicates that the 5GHz frequency band should be
  enabled for this device. This must not be used together with the
  "disable-ieee80211-5ghz" at the same time.
- disable-ieee80211-2ghz: indicates that the 2.4GHz frequency band should be
  disabled for this device.
- disable-ieee80211-5ghz: indicates that the 5GHz frequency band should be
  disabled for this device
```
