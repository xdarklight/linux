## Documentation/devicetree/bindings/arm/amlogic/pmu.txt
```
Amlogic Meson8 and Meson8b power-management-unit:
-------------------------------------------------

The pmu is used to turn off and on different power domains of the SoCs
This configures the power and isolation of various components such as
the CPU cores, video decoders and the HDMI controller.

Required node properties:
- compatible value : depending on the SoC this should be one of:
			"amlogic,meson8-pmu"
			"amlogic,meson8b-pmu"
- reg : physical base address and the size of the registers window
- #power-domain-cells : must be 1

Example:

	pmu@c81000e4 {
		compatible = "amlogic,meson8b-pmu", "syscon";
		reg = <0xc81000e0 0x18>;
		#power-domain-cells = <1>;
	};
```

## Documentation/devicetree/bindings/clock/lantiq,falcon-clocks.txt
```
* Clock bindings for the clocks found on on Lantiq Falcon SoCs

Required properties:
- compatible:	Has to be one of the following
	- "lantiq,sys1-falcon"
	- "lantiq,syseth-falcon"
- reg:		Address and length of the register set
- #clock-cells:	Should be <1>

Each clock is assigned an identifier and client nodes can use this identifier
to specify the clock which they consume. All available clocks are defined as
preprocessor macros in the include/dt-bindings/clock/lantiq-falcon.h
header and can be used in device tree sources.
```

## Documentation/devicetree/bindings/clock/lantiq,xway-cgu-clock.txt
```
* Clock bindings for the CGU (Clock Generation Unit) on Lantiq XWAY SoCs

Required properties:
- compatible:	Has to be one of the following
	- "lantiq,arx100-cgu"
	- "lantiq,arx300-cgu"
	- "lantiq,ase-cgu"
	- "lantiq,danube-cgu"
	- "lantiq,grx390-cgu"
	- "lantiq,vrx200-cgu"
	- "lantiq,cgu-xway" (deprecated, should not be used anymore)
- reg:		Address and length of the register set
- #clock-cells:	Should be <1>

Optional properties:
- lantiq,gphy-clk-select:	Defines the clock-source for the internal GPHY
				clock. All available values are defined as
				preprocessor macros (CGU_GPHY_CLK_*) in
				include/dt-bindings/clock/lantiq-xway-cgu.h

Each clock is assigned an identifier and client nodes can use this identifier
to specify the clock which they consume. All available clocks are defined as
preprocessor macros in the include/dt-bindings/clock/lantiq-xway-cgu.h
header and can be used in device tree sources.
```

## Documentation/devicetree/bindings/clock/lantiq,xway-pmu-clock.txt
```
* Clock bindings for the PMU (Power Management Unit) gates on Lantiq XWAY SoCs

Required properties:
- compatible:	Has to be one of the following
	- "lantiq,arx300-pmu"
	- "antiq,ase-pmu"
	- "lantiq,danube-pmu"
	- "lantiq,grx300-pmu"
	- "lantiq,xrx100-pmu"
	- "lantiq,xrx200-pmu"
	- "lantiq,pmu-xway" (deprecated, should not be used anymore)
- reg:		Address and length of the register set
- #clock-cells:	Should be <1>

Each clock is assigned an identifier and client nodes can use this identifier
to specify the clock which they consume. All available clocks are defined as
preprocessor macros in the following (SoC specific) headers and can be used in
device tree sources:
	- include/dt-bindings/clock/lantiq-pmu-arx300.h
	- include/dt-bindings/clock/lantiq-pmu-ase.h
	- include/dt-bindings/clock/lantiq-pmu-danube.h
	- include/dt-bindings/clock/lantiq-pmu-grx300.h
	- include/dt-bindings/clock/lantiq-pmu-xrx200.h
	- include/dt-bindings/clock/lantiq-pmu-xrx100.h
```

## Documentation/devicetree/bindings/firmware/meson/amlogic,meson-mx-trustzone-firmware.yaml
```yaml
# SPDX-License-Identifier: (GPL-2.0 OR BSD-2-Clause)
# Copyright 2021 Martin Blumenstingl <martin.blumenstingl@googlemail.com>
%YAML 1.2
---
$id: "http://devicetree.org/schemas/firmware/meson/amlogic,meson-mx-trustzone-firmware.yaml#"
$schema: "http://devicetree.org/meta-schemas/core.yaml#"

title: Amlogic Meson6/8/8b/8m2 TrustZone secure firmware

description: |
  Amlogic Meson6/8/8b/8m2 SoCs can optionally use a TrustZone secure
  firmware. This prevents anything outside of the TEE (Trusted
  Execution Environment aka TrustZone secure firmware) from accessing
  certain functionality of these SoCs, such as (but not limited to):
  Bringing up/down secondary SMP cores, accessing the eFuse and getting
  the SoC misc version.
  ARM SMCCC is used for communication with the TrustZone secure
  firmware.

maintainers:
  - Martin Blumenstingl <martin.blumenstingl@googlemail.com>

properties:
  compatible:
    oneOf:
      - items:
          - enum:
              - amlogic,meson6-trustzone-firmware
              - amlogic,meson8-trustzone-firmware
              - amlogic,meson8b-trustzone-firmware
              - amlogic,meson8m2-trustzone-firmware
          - const: amlogic,meson-mx-trustzone-firmware

required:
  - compatible

additionalProperties: false

examples:
  - |
    firmware {
      trustzone-firmware {
        compatible = "amlogic,meson8m2-trustzone-firmware",
                     "amlogic,meson-mx-trustzone-firmware";
      };
    };
...
```

## Documentation/devicetree/bindings/interrupt-controller/lantiq,icu.yaml
```yaml
# SPDX-License-Identifier: (GPL-2.0-only OR BSD-2-Clause)
%YAML 1.2
---
$id: "http://devicetree.org/schemas/interrupt-controller/lantiq,icu.yaml#"
$schema: "http://devicetree.org/meta-schemas/core.yaml#"

title: Lantiq ICU (Interrupt Controller Unit)

maintainers:
  - Martin Blumenstingl <martin.blumenstingl@googlemail.com>

allOf:
  - $ref: /schemas/interrupt-controller.yaml#

description:
  The Lantiq Falcon, Amazon-SE, Danube, xRX100, xRX200 and xRX300 SoCs
  come with an "Interrupt Controller Unit" (ICU). This is is a 5 to
  160 (5 * 32) multiplexer and connects to most peripherals on these
  SoCs.

properties:
  compatible:
    items:
      - enum:
          - lantiq,falcon-icu
          - lantiq,ase-icu
          - lantiq,danube-icu
          - lantiq,xrx100-icu
          - lantiq,xrx200-icu
          - lantiq,xrx300-icu
      - const: lantiq,icu

  reg:
    description: One set of registers per CPU core
    minItems: 1
    maxItems: 2

  interrupts:
    minItems: 5

  interrupt-controller: true

  '#interrupt-cells':
    const: 1

  '#address-cells':
    const: 1

required:
  - compatible
  - reg
  - interrupt-parent
  - interrupts
  - interrupt-controller
  - '#interrupt-cells'
  - '#address-cells'

additionalProperties: false

examples:
  - |
    interrupt-controller@80200 {
      compatible = "lantiq,ase-icu", "lantiq,icu";
      reg = <0x80200 0xc8>;
      interrupt-parent = <&cpu_irqc>;
      interrupts = <2>, <3>, <4>, <5>, <6>;
      interrupt-controller;
      #interrupt-cells = <1>;
      #address-cells = <1>;
    };
  - |
    interrupt-controller@80200 {
      compatible = "lantiq,xrx200-icu", "lantiq,icu";
      reg = <0x80200 0xc8>, <0x80300 0xc8>;
      interrupt-parent = <&cpu_irqc>;
      interrupts = <2>, <3>, <4>, <5>, <6>;
      interrupt-controller;
      #interrupt-cells = <1>;
      #address-cells = <1>;
    };
...
```

## Documentation/devicetree/bindings/interrupt-controller/lantiq,msi-pic.yaml
```yaml
# SPDX-License-Identifier: (GPL-2.0-only OR BSD-2-Clause)
%YAML 1.2
---
$id: "http://devicetree.org/schemas/interrupt-controller/lantiq,msi-pic.yaml#"
$schema: "http://devicetree.org/meta-schemas/core.yaml#"

title: Lantiq MSI Programmable Interrupt Controller

maintainers:
  - Martin Blumenstingl <martin.blumenstingl@googlemail.com>

allOf:
  - $ref: /schemas/interrupt-controller.yaml#

description:
  The Lantiq MSI Programmable Interrupt Controller is used in the
  Lantiq xRX200 and xRX300 SoCs.

properties:
  compatible:
    enum:
      - lantiq,xrx200-msi-pic
      - lantiq,xrx300-msi-pic

  reg:
    maxItems: 2

  reg-names:
    items:
      - const: pic
      - const: msi

  clocks:
    minItems: 1

  lantiq,msi-irqs:
    $ref: "/schemas/types.yaml#/definitions/uint32-array"
    description:
      The interrupt lines of the SoC's interrupt-controller, one for
      each MSI.
    minItems: 4
    maxItems: 8

  msi-controller: true

required:
  - compatible
  - reg
  - reg-names
  - clocks
  - msi-controller
  - lantiq,msi-irqs

additionalProperties: false

examples:
  - |
    #include <dt-bindings/interrupt-controller/irq.h>
    msi: interrupt-controller@1f700000 {
      compatible = "lantiq,xrx200-msi-pic";
      reg = <0x1f700000 0x44>, <0x1f600000 0x100000>;
      reg-names = "pic", "msi";
      clocks = <&msi_pci_clock>;
      interrupt-parent = <&icu0>;
      msi-controller;
      lantiq,msi-irqs = <163>, <164>, <165>, <166>;
    };
...
```

## Documentation/devicetree/bindings/interrupt-controller/lantiq,xway-eiu.yaml
```yaml
# SPDX-License-Identifier: (GPL-2.0-or-later OR BSD-2-Clause)
%YAML 1.2
---
$id: "http://devicetree.org/schemas/interrupt-controller/lantiq,xway-eiu.yaml#"
$schema: "http://devicetree.org/meta-schemas/core.yaml#"

title: Lantiq XWAY External Interrupt Unit

description: |
  This interrupt controller is found in the Lantiq XWAY SoCs.
  It is the GPIO interrupt controller, also called "EIU" (which
  stands for External Interrupt Unit).

allOf:
  - $ref: /schemas/interrupt-controller.yaml#

maintainers:
  - Martin Blumenstingl <martin.blumenstingl@googlemail.com>

properties:
  compatible:
    items:
      - enum:
          - lantiq,ase-eiu
          - lantiq,danube-eiu
          - lantiq,xrx100-eiu
          - lantiq,xrx200-eiu
          - lantiq,xrx300-eiu
      - const: lantiq,xway-eiu

  reg:
    maxItems: 1

  lantiq,eiu-irqs:
    $ref: /schemas/types.yaml#/definitions/uint32-array
    minItems: 1
    maxItems: 6
    description: One ICU interrupt specifier for each EIU

  interrupt-controller: true

  '#interrupt-cells':
    const: 2

  '#address-cells':
    const: 2

required:
  - compatible
  - reg
  - lantiq,eiu-irqs
  - interrupt-controller
  - '#interrupt-cells'
  - '#address-cells'

additionalProperties: false

examples:
  - |
    interrupt-controller@101000 {
      compatible = "lantiq,xrx200-eiu", "lantiq,xway-eiu";
      reg = <0x101000 0x10>;
      interrupt-parent = <&icu0>;
      lantiq,eiu-irqs = <158>, <127>, <58>, <32>, <33>, <34>;
      interrupt-controller;
      #interrupt-cells = <2>;
      #address-cells = <2>;
    };
...
```

## Documentation/devicetree/bindings/mailbox/amlogic,meson-mx-ao-arc-mbox.yaml
```yaml
# SPDX-License-Identifier: (GPL-2.0-only OR BSD-2-Clause)
%YAML 1.2
---
$id: "http://devicetree.org/schemas/mailbox/amlogic,meson-mx-ao-arc-mbox.yaml#"
$schema: "http://devicetree.org/meta-schemas/core.yaml#"

title: Amlogic Meson AO ARC Remote Processor mailbox bindings

description:
  Amlogic Meson6, Meson8, Meson8b and Meson8m2 SoCs have a mailbox
  to communicate with the embedded an ARC EM4 core.

maintainers:
  - Martin Blumenstingl <martin.blumenstingl@googlemail.com>

properties:
  compatible:
    const: amlogic,meson-mx-ao-arc-mbox

  reg:
    minItems: 1

  "#mbox-cells":
    const: 1

required:
  - compatible
  - reg
  - "#mbox-cells"

additionalProperties: false

examples:
  - |
    mailbox@0 {
      compatible= "amlogic,meson-mx-ao-arc-mbox";
      reg = <0x0 0xc>;
      #mbox-cells = <1>;
    };

...
```

## Documentation/devicetree/bindings/mips/lantiq/lantiq,ebu.yaml
```yaml
# SPDX-License-Identifier: (GPL-2.0-only OR BSD-2-Clause)
%YAML 1.2
---
$id: http://devicetree.org/schemas/mips/lantiq/lantiq,ebu.yaml#
$schema: http://devicetree.org/meta-schemas/core.yaml#

title: Lantiq Xway SoC series External Bus Unit (EBU)

maintainers:
  - John Crispin <john@phrozen.org>
  - Martin Blumenstingl <martin.blumenstingl@googlemail.com>

properties:
  compatible:
    enum:
      - lantiq,ebu-falcon # deprecated
      - lantiq,ebu-xway # deprecated
      - lantiq,falcon-ebu
      - lantiq,ase-ebu
      - lantiq,danube-ebu
      - lantiq,xrx100-ebu
      - lantiq,xrx200-ebu

  reg:
    maxItems: 1

  clocks:
    minItems: 1

  interrupt-controller: true

  '#interrupt-cells':
    const: 2

  '#address-cells':
    const: 1

  '#size-cells':
    const: 1

  ranges: true

  interrupts:
    minItems: 1

  big-endian: true

patternProperties:
  "^nand-controller@[0-9a-f]+$":
    type: object
    $ref: "../mtd/intel,lgm-nand.yaml"

required:
  - compatible
  - reg
  - clocks

additionalProperties: false

examples:
  - |
    bus@e105300 {
        compatible = "lantiq,ase-ebu";
        reg = <0xe105300 0x100>;

        clocks = <&pmu 10>;

        big-endian;
    };
  - |
    bus@e105300 {
        compatible = "lantiq,xrx200-ebu";
        reg = <0xe105300 0x100>;

        clocks = <&pmu 10>;

        interrupt-controller;
        #interrupt-cells = <2>;
        interrupts = <30>;

        big-endian;

        #address-cells = <1>;
        #size-cells = <1>;
        ranges;

        nand-controller@1e1053b0 {
            compatible = "lantiq,danube-ebunand";
            reg = <0x1e1053b0 0x14>,
                  <0x14000000 0x1000>,
                  <0x14000000 0x1000>,
                  <0x14000000 0x4>,
                  <0x14000000 0x4>;
            reg-names = "ebunand",
                        "nand_cs0",
                        "nand_cs1",
                        "addr_sel0",
                        "addr_sel1";

            #address-cells = <1>;
            #size-cells = <0>;
        };
    };
...
```

## Documentation/devicetree/bindings/mips/lantiq/lantiq,xway-mps-chipid.yaml
```yaml
# SPDX-License-Identifier: (GPL-2.0-only OR BSD-2-Clause)
%YAML 1.2
---
$id: "http://devicetree.org/schemas/mips/lantiq/lantiq,xway-mps.yaml#"
$schema: "http://devicetree.org/meta-schemas/core.yaml#"

title: Lantiq MPS (multi processor unit - voice) chip ID

maintainers:
  - Martin Blumenstingl <martin.blumenstingl@googlemail.com>

properties:
  compatible:
    const: lantiq,xway-mps-chipid

  reg:
    minItems: 1

required:
  - compatible
  - reg

additionalProperties: false

examples:
  - |
    remoteproc@107344 {
      compatible= "lantiq,xway-mps-chipid";
      reg = <0x107344 0x4>;
    };

...
```

## Documentation/devicetree/bindings/mips/lantiq/rcu-gphy.txt
```
Lantiq XWAY SoC GPHY binding
============================

This binding describes a software-defined ethernet PHY, provided by the RCU
module on newer Lantiq XWAY SoCs (xRX200 and newer).
This depends on binary firmware blobs which must be provided by userspace.


-------------------------------------------------------------------------------
Required properties (controller (parent) node):
- compatible		: Should be one of
				"lantiq,xrx200-rcu-gphy"
				"lantiq,xrx300-rcu-gphy"
				"lantiq,xrx330-rcu-gphy"
- lantiq,rcu-syscon	: A phandle and offset to the GPHY address registers in
			  the RCU
- resets		: Must reference the RCU GPHY reset bit
- reset-names		: One entry, value must be "gphy"

Optional properties (port (child) node):
- lantiq,gphy-mode	: GPHY_MODE_GE (default) or GPHY_MODE_FE as defined in
			  <dt-bindings/mips/lantiq_xway_gphy.h>
- clocks		: A reference to the (PMU) GPHY clock gate
- clock-names		: If clocks is given then this must be "gphy"


-------------------------------------------------------------------------------
Example for the GPHys on the xRX200 SoCs:
	gphy0: rcu_gphy {
		compatible = "lantiq,xrx200-rcu-gphy";
		lantiq,rcu-syscon = <&rcu0 0x20>;
		resets = <&rcu_reset0 31>;
		reset-names = "gphy";
		lantiq,gphy-mode = <GPHY_MODE_GE>;
		clocks = <&pmu0 XRX200_PMU_GATE_GPHY>;
		clock-names = "gphy";
	};

	gphy1: rcu_gphy {
		compatible = "lantiq,xrx200-rcu-gphy";
		lantiq,rcu-syscon = <&rcu0 0x68>;
		resets = <&rcu_reset0 29>;
		reset-names = "gphy";
		lantiq,gphy-mode = <GPHY_MODE_FE>;
		clocks = <&pmu0 XRX200_PMU_GATE_GPHY>;
		clock-names = "gphy";
	};
```
